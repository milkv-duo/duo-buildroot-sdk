## ramdisk/rootfs/public/ntp/Kconfig
```kconfig
config TARGET_PACKAGE_NTP
	bool "Target package ntp"
	default n
	help
	ntp version: 4.2.8p15
```

## ramdisk/rootfs/public/openssl/Kconfig
```kconfig
config TARGET_PACKAGE_OPENSSL
	bool "Target package openssl"
	default n
	help
	  target package openssl
```

## ramdisk/rootfs/public/otaserver/Kconfig
```kconfig
config TARGET_PACKAGE_OTASERVER
	bool "Target package ota server"
    default y
	help
	  target package ota server
```

## ramdisk/rootfs/public/parted/Kconfig
```kconfig
config TARGET_PACKAGE_PARTED
	bool "Target package parted"
	default n
	help
	  target package parted
```

## ramdisk/rootfs/public/pinmux/Kconfig
```kconfig
config TARGET_PACKAGE_PINMUX
	bool "Target package pinmux"
	default n
	help
	source code: ramdisk/tools/cvi_pinmux
```

## ramdisk/rootfs/public/procps/Kconfig
```kconfig
config TARGET_PACKAGE_PROCPS
	bool "Target package procps"
	default n
	help
	procps Version:3.3.17
	procps is a set of command line and full-screen utilities that provide
	information out of the pseudo-filesystem most commonly located at /proc.
	This filesystem provides a simple interface to the kernel data structures.
	The programs of procps generally concentrate on the structures that describe
	the processess running on the system.
	The following programs are found in procps:

	free - Report the amount of free and used memory in the system
	kill - Send a signal to a process based on PID
	pgrep - List processes based on name or other attributes
	pkill - Send a signal to a process based on name or other attributes
	pmap - Report memory map of a process
	ps - Report information of processes
	pwdx - Report current directory of a process
	top - Dynamic real-time view of running processes
	uptime - Display how long the system has been running
	vmstat - Report virtual memory statistics
	w - Report logged in users and what they are doing
```

## ramdisk/rootfs/public/procrank/Kconfig
```kconfig
config TARGET_PACKAGE_PROCRANK
	bool "Target package procrank"
	default n
	help
	  target procrank
```

## ramdisk/rootfs/public/python3.7/Kconfig
```kconfig
config TARGET_PACKAGE_PYTHON3.7
	bool "Target package python3.7"
	default n
	help
	  target package python3.7
```

## ramdisk/rootfs/public/rsyslog/Kconfig
```kconfig
config TARGET_PACKAGE_RSYSLOG
	bool "Target package rsyslog"
	default y
	help
	  target package rsyslog
```

## ramdisk/rootfs/public/secure_image/Kconfig
```kconfig
config TARGET_PACKAGE_SECURE_IMAGE
	bool "Target package secure_image"
	default "y" if TOOLCHAIN_GLIBC_ARM64
	default "n" if TOOLCHAIN_GLIBC_ARM
	default "n" if TOOLCHAIN_UCLIBC_ARM
	help
	  target package secure_image
```

## ramdisk/rootfs/public/stress-ng/Kconfig
```kconfig
config TARGET_PACKAGE_STRESS
	bool "Target package stress-ng"
	default n
	help
		stress-ng Ver: 0.14.00
		stress-ng will stress test a computer system in various selectable ways.
		It was designed to exercise various physical subsystems of a computer as well as the various operating system kernel interfaces. 
```

## ramdisk/rootfs/public/wifi/Kconfig
```kconfig
config TARGET_PACKAGE_WIFI
	bool "Target package wifi"
	default n
	help
	  target package wifi
```

## u-boot-2021.10/board/cvitek/Kconfig
```kconfig
if TARGET_CVITEK_ARM || TARGET_CVITEK_RISCV

config TARGET_CVITEK
	def_bool n
	select ARM64 if TARGET_CVITEK_ARM
	select GENERIC_RISCV if TARGET_CVITEK_RISCV
	select ENABLE_ARM_SOC_BOOT0_HOOK if TARGET_CVITEK_ARM

choice
	prompt "Cvitek target"

config TARGET_CVITEK_CV1835
	bool "Support CVITEK CV1835"
	select TARGET_CVITEK

config TARGET_CVITEK_CV1822
	bool "Support CVITEK CV1822"
	select TARGET_CVITEK

config TARGET_CVITEK_CV181X
	bool "Support CVITEK CV181X"
	select TARGET_CVITEK

config TARGET_CVITEK_CV180X
	bool "Support CVITEK CV180X"
	select TARGET_CVITEK

endchoice

source "board/cvitek/cv1835/Kconfig"
source "board/cvitek/cv1822/Kconfig"
source "board/cvitek/cv181x/Kconfig"
source "board/cvitek/cv180x/Kconfig"

endif
```

## u-boot-2021.10/board/cvitek/cv180x/Kconfig
```kconfig
if TARGET_CVITEK_CV180X

choice
	prompt "Cvitek CV180X verification platform type select"
	help
	  Select the board version of the shc board.

config TARGET_CVITEK_CV180X_ASIC
	bool "ASIC"
	help
	  This enables support for Cvitek's CV180X SoC on ASIC platform.

	  If unsure, say N.

config TARGET_CVITEK_CV180X_PALLADIUM
	bool "Palladium"
	help
	  This enables support for Cvitek's CV180X SoC on PALLADIUM platform.

	  If unsure, say N.

config TARGET_CVITEK_CV180X_FPGA
	bool "FPGA"
	help
	  This enables support for Cvitek's CV180X SoC on FPGA platform.

	  If unsure, say N.

endchoice

config SYS_BOARD
	default "cv180x"

config SYS_VENDOR
	default "cvitek"

config SYS_CPU
	default "generic"

config SYS_CONFIG_NAME
	default "cv180x-asic" if TARGET_CVITEK_CV180X_ASIC
	default "cv180x-palladium" if TARGET_CVITEK_CV180X_PALLADIUM
	default "cv180x-fpga" if TARGET_CVITEK_CV180X_FPGA

config CVITEK_SPI_FLASH
    bool
	prompt "Support CVITEK SPINOR"
    select SPI_FLASH
	select DM
	select DM_SPI
	select DM_SPI_FLASH
	select SPI_MEM
	select CMD_SF
    select CVI_SPIF
    select ENV_IS_IN_SPI_FLASH

config ENV_SIZE
    default 0x10000 if ENV_IS_IN_SPI_FLASH
    default 0x20000 if ENV_IS_IN_MMC
	default 0x20000 if ENV_IS_IN_NAND

config ENV_SECT_SIZE
	default 0x10000 if ENV_IS_IN_SPI_FLASH
	default 0x40000 if ENV_IS_IN_MMC
	default 0x20000 if ENV_IS_IN_NAND

config ENV_OFFSET
    default 0x3A0000 if ENV_IS_IN_SPI_FLASH
    default 0x880000 if ENV_IS_IN_MMC
	default 0xae0000 if ENV_IS_IN_NAND

config ENV_OFFSET_REDUND
    default 0x3B0000 if ENV_IS_IN_SPI_FLASH
	default 0xb00000 if ENV_IS_IN_NAND

endif
```

## u-boot-2021.10/board/cvitek/cv181x/Kconfig
```kconfig
if TARGET_CVITEK_CV181X

choice
	prompt "Cvitek CV181X verification platform type select"

config TARGET_CVITEK_CV181X_ASIC
	bool "ASIC"
	help
	  This enables support for Cvitek's CV181X SoC on ASIC platform.

	  If unsure, say N.

config TARGET_CVITEK_CV181X_PALLADIUM
	bool "Palladium"
	help
	  This enables support for Cvitek's CV181X SoC on PALLADIUM platform.

	  If unsure, say N.

config TARGET_CVITEK_CV181X_FPGA
	bool "FPGA"
	help
	  This enables support for Cvitek's CV181X SoC on FPGA platform.

	  If unsure, say N.

endchoice

config SYS_BOARD
	default "cv181x"

config SYS_VENDOR
	default "cvitek"

config SYS_CPU
	default "generic"

config SYS_CONFIG_NAME
	default "cv181x-asic" if TARGET_CVITEK_CV181X_ASIC
	default "cv181x-palladium" if TARGET_CVITEK_CV181X_PALLADIUM
	default "cv181x-fpga" if TARGET_CVITEK_CV181X_FPGA

config CVITEK_SPI_FLASH
    bool
	prompt "Support CVITEK SPINOR"
    select SPI_FLASH
	select DM
	select DM_SPI
	select DM_SPI_FLASH
	select SPI_MEM
	select CMD_SF
    select CVI_SPIF

config ENV_SIZE
    default 0x10000 if ENV_IS_IN_SPI_FLASH
    default 0x20000 if ENV_IS_IN_MMC
	default 0x20000 if ENV_IS_IN_NAND

config ENV_SECT_SIZE
	default 0x10000 if ENV_IS_IN_SPI_FLASH
	default 0x40000 if ENV_IS_IN_MMC
	default 0x20000 if ENV_IS_IN_NAND

config ENV_OFFSET
    default 0x3A0000 if ENV_IS_IN_SPI_FLASH
    default 0x880000 if ENV_IS_IN_MMC
	default 0xae0000 if ENV_IS_IN_NAND

config ENV_OFFSET_REDUND
    default 0x3B0000 if ENV_IS_IN_SPI_FLASH
	default 0xb00000 if ENV_IS_IN_NAND

endif
```

## u-boot-2021.10/board/cvitek/cv1822/Kconfig
```kconfig
if TARGET_CVITEK_CV1822

choice
	prompt "Cvitek CV1822 verification platform type select"

config TARGET_CVITEK_CV1822_ASIC
	bool "ASIC"
	help
	  This enables support for Cvitek's CV1822 SoC on ASIC platform.

	  If unsure, say N.

config TARGET_CVITEK_CV1822_PALLADIUM
	bool "Palladium"
	help
	  This enables support for Cvitek's CV1822 SoC on PALLADIUM platform.

	  If unsure, say N.

config TARGET_CVITEK_CV1822_FPGA
	bool "FPGA"
	help
	  This enables support for Cvitek's CV1822 SoC on FPGA platform.

	  If unsure, say N.

endchoice

config SYS_BOARD
	default "cv1822"

config SYS_VENDOR
	default "cvitek"

config SYS_CONFIG_NAME
	default "cv1822-asic" if TARGET_CVITEK_CV1822_ASIC
	default "cv1822-palladium" if TARGET_CVITEK_CV1822_PALLADIUM
	default "cv1822-fpga" if TARGET_CVITEK_CV1822_FPGA

config SYS_BOOTMAPSZ
	hex "Maximum size of memory mapped"
	default "0x8000000"

endif
```

## u-boot-2021.10/board/cvitek/cv1835/Kconfig
```kconfig
if TARGET_CVITEK_CV1835

choice
	prompt "Cvitek CV1835 verification platform type select"

config TARGET_CVITEK_CV1835_ASIC
	bool "ASIC"
	help
	  This enables support for Cvitek's CV1835 SoC on ASIC platform.

	  If unsure, say N.

config TARGET_CVITEK_CV1835_PALLADIUM
	bool "Palladium"
	help
	  This enables support for Cvitek's CV1835 SoC on PALLADIUM platform.

	  If unsure, say N.

config TARGET_CVITEK_CV1835_FPGA
	bool "FPGA"
	help
	  This enables support for Cvitek's CV1835 SoC on FPGA platform.

	  If unsure, say N.

endchoice

config SYS_BOARD
	default "cv1835"

config SYS_VENDOR
	default "cvitek"

config SYS_CONFIG_NAME
	default "cv1835-asic" if TARGET_CVITEK_CV1835_ASIC
	default "cv1835-palladium" if TARGET_CVITEK_CV1835_PALLADIUM
	default "cv1835-fpga" if TARGET_CVITEK_CV1835_FPGA

config SYS_BOOTMAPSZ
	hex "Maximum size of memory mapped"
	default "0x10000000"

endif
```

## u-boot-2021.10/drivers/cvi_sound/Kconfig
```kconfig
menu "Cvitek Sound support"

config CVI_SOUND_DRIVERS
	bool "Enable cvitek sound support"
	help
	  Support making sounds through an audio codec. This is normally a
	  beep at a chosen frequency for a selected length of time. However
	  the drivers support playing arbitrary sound samples using a
	  PCM interface.


endmenu
```

## u-boot-2021.10/drivers/video/cvitek/Kconfig
```kconfig
#
# Video drivers selection for cvitek soc.
#

menuconfig VIDEO_CVITEK
	bool "Enable Cvitek Video Support"
	depends on DM_VIDEO || BOOTLOGO
	default y if DM_VIDEO || BOOTLOGO
	help
	  Cvitek SoCs provide video output capabilities for Low-voltage
	  Differential Signalling (LVDS), and Display Serial Interface (DSI).

	  This driver supports the on-chip video output device, and targets the
	  Cvitek CV1835.

config VIDEO_CVITEK_MAX_XRES
        int "Maximum horizontal resolution (for memory allocation purposes)"
	depends on VIDEO_CVITEK
	default 1920
	help
	  The maximum horizontal resolution to support for the framebuffer.
	  This configuration is used for reserving/allocating memory for the
	  framebuffer during device-model binding/probing.

config VIDEO_CVITEK_MAX_YRES
        int "Maximum vertical resolution (for memory allocation purposes)"
	depends on VIDEO_CVITEK
	default 1080
	help
	  The maximum vertical resolution to support for the framebuffer.
	  This configuration is used for reserving/allocating memory for the
	  framebuffer during device-model binding/probing.

if VIDEO_CVITEK

choice
	prompt "Display port selection"
	default DISPLAY_CVITEK_MIPI
	depends on VIDEO_CVITEK
	help
	  Select one kind of display port.

config DISPLAY_CVITEK_LVDS
	bool "LVDS Port"
	help
	  This enables Low-voltage Differential Signaling(LVDS) display support.
	  LVDS is a high-speed, long-distance digital interface for serial
	  communication (sending one bit at time) over two copper wires
	  (differential) that are placed at 180 degrees from each other.

config DISPLAY_CVITEK_I80
	bool "I80 Port"
	help
	  This enables Intel 8080(I80) display support.
	  Intel 8080 (I80) is one kind of the most common LCD MPU parallel
	  interfaces, LCD controller signals are divided into two types:
	  data signals and control signals.

config DISPLAY_CVITEK_MIPI
	bool "DSI Port"
	help
	  This enables Display Serial Interface(DSI) display support.
	  The MIPI Display Serial Interface (MIPI DSI) defines a
	  high-speed serial interface between a host processor and
	  a display module.

config MIPI_PANEL_LANE_SWAP
	bool "MIPI DSI lane PN swap"
	help
          This enables Display Serial Interface(DSI) lane PN swap function.

endchoice

endif
```
