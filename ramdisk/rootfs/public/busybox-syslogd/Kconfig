## ramdisk/rootfs/public/busybox-syslogd/Kconfig
```kconfig
config TARGET_PACKAGE_BUSYBOX_SYSLOGD_SCRIPT
        bool "Target package busybox-syslogd script"
	default n
        help
          target package busybox-syslogd script
```

## ramdisk/rootfs/public/crontabs/Kconfig
```kconfig
config TARGET_PACKAGE_CRONTABS
	bool "Target package crontabs"
	default y
	help
	  target package crontabs
```

## ramdisk/rootfs/public/cvitracer/Kconfig
```kconfig
config TARGET_PACKAGE_CVITRACER
	bool "Target package cvitracer"
	default y if MW_VER="v1"
	default n if MW_VER="v2"
	help
	  target cvitracer
```

## ramdisk/rootfs/public/dropbear/Kconfig
```kconfig
config TARGET_PACKAGE_DROPBEAR
	bool "Target package dropbear"
	default n
	help
	  target dropbear
```

## ramdisk/rootfs/public/e2fsprogs/Kconfig
```kconfig
config TARGET_PACKAGE_E2FSPROGS
	bool "Target package e2fsprogs"
	default n
	help
		"The EXT2 file system utilities."
```

## ramdisk/rootfs/public/envtools/Kconfig
```kconfig
config TARGET_PACKAGE_ENVTOOLS
	bool "Target package envtools"
	default n
	help
	envtools version: u-boot-2021.10
	source code:u-boot-2021.10/tools/env
	build by "make envtools"
```

## ramdisk/rootfs/public/gatord/Kconfig
```kconfig
config TARGET_PACKAGE_GATORD
	bool "Target package gatord"
	default y
	help
	  target gatord
```

## ramdisk/rootfs/public/gdbserver/Kconfig
```kconfig
config TARGET_PACKAGE_GDBSERVER
	bool "Target package gdbserver"
    default y
	help
	  target package gdbserver
```

## ramdisk/rootfs/public/haasui/Kconfig
```kconfig
config TARGET_PACKAGE_HAASUI
	bool "Target package haasui"
	help
	  target package haasui
```

## ramdisk/rootfs/public/htop/Kconfig
```kconfig
config TARGET_PACKAGE_HTOP
	bool "Target package htop"
	default n
	help
	htop Version: 1.0.3
	Htop is a free (GPL) NCourses based Linux process viewer. It is similar to top.
```

## ramdisk/rootfs/public/i2c_tool/Kconfig
```kconfig
config TARGET_PACKAGE_I2CTOOL
	bool "Target package i2ctool"
	default n
	help
	source code:ramdisk/tools/i2c_tool
```

## ramdisk/rootfs/public/iperf3-3.1.7/Kconfig
```kconfig
config TARGET_PACKAGE_IPERF3
	bool "Target package iperf3 tools"
	default n
	help
	  target package iperf3-3.1.7
```

## ramdisk/rootfs/public/libbtrace/Kconfig
```kconfig
config TARGET_PACKAGE_LIBBTRACE
	bool "Target package libbtrace"
	default n
	help
	  target package libbtrace
```

## ramdisk/rootfs/public/libcrypto/Kconfig
```kconfig
config TARGET_PACKAGE_LIBCRYPTO
	bool "Target package libcrypto"
	default y
	help
	  target package libcrypto
```

## ramdisk/rootfs/public/libcurl/Kconfig
```kconfig
config TARGET_PACKAGE_LIBCURL
	bool "Target package libcurl"
	default n
	help
	  target package libcurl
```

## ramdisk/rootfs/public/libevent/Kconfig
```kconfig
config TARGET_PACKAGE_LIBEVENT
	bool "Target package libevent"
	default n
	help
	  target package libevent
```

## ramdisk/rootfs/public/libiperf/Kconfig
```kconfig
config TARGET_PACKAGE_LIBIPERF
	bool "Target package libiperf"
	default n
	help
	  target package libiperf
```

## ramdisk/rootfs/public/libiw/Kconfig
```kconfig
config TARGET_PACKAGE_LIBIW
	bool "Target package libiw"
	default n
	help
	  target package libiw
```

## ramdisk/rootfs/public/libnfs/Kconfig
```kconfig
config TARGET_PACKAGE_LIBNFS
	bool "Target package libnfs"
	default n
	help
	  target package libnfs
```

## ramdisk/rootfs/public/libprotobuf/Kconfig
```kconfig
config TARGET_PACKAGE_LIBPROTOBUF
	bool "Target package libprotobuf"
	default n
	help
	  target package libprotobuf
```

## ramdisk/rootfs/public/libtirpc/Kconfig
```kconfig
config TARGET_PACKAGE_LIBTIRPC
	bool "Target package libtirpc"
	default n
	help
	  target package libtirpc (use libtirpc instead RPC)
```

## ramdisk/rootfs/public/libz/Kconfig
```kconfig
config TARGET_PACKAGE_LIBZ
	bool "Target package libz"
	default y
	help
	  target package libz
```

## ramdisk/rootfs/public/mt7603u/Kconfig
```kconfig
config TARGET_PACKAGE_MT7603U
	bool "Target package mt7603u conf files"
	default n
	help
	  target package mt7603u conf files
```

## ramdisk/rootfs/public/mtd-utils/Kconfig
```kconfig
config TARGET_PACKAGE_MTD-UTILS
	bool "Target package mtd-utils"
	default n
	help
	  target package mtd-utils
```

## ramdisk/rootfs/public/nanomsg/Kconfig
```kconfig
config TARGET_PACKAGE_NANOMSG
	bool "Target package nanomsg"
	default n
	help
	  target nanomsg
```
