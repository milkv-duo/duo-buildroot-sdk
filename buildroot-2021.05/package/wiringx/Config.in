## linux_5.10/arch/arm64/configs/cvitek_cv9520_asic_evb_defconfig
```kconfig
#
# PLATFORM
#
CONFIG_SYSVIPC=y
CONFIG_POSIX_MQUEUE=y
CONFIG_FHANDLE=y
CONFIG_NO_HZ_IDLE=y
CONFIG_HIGH_RES_TIMERS=y
CONFIG_TASKSTATS=y
CONFIG_SCHED_AUTOGROUP=y
CONFIG_PROFILING=y
CONFIG_MODULES=y
CONFIG_MODULE_UNLOAD=y
CONFIG_MODULE_FORCE_LOAD=y
CONFIG_MODULE_FORCE_UNLOAD=y
CONFIG_BLK_DEV_BSGLIB=y
CONFIG_ARCH_CVITEK=y
CONFIG_ARCH_CVITEK_CHIP="cv952x"
CONFIG_ARCH_CV952X=y
CONFIG_ARCH_CV952X_ASIC=y
CONFIG_SMP=y
CONFIG_TRANSPARENT_HUGEPAGE=y
CONFIG_COMPAT=y
CONFIG_NET=y
CONFIG_PACKET=y
CONFIG_PACKET_DIAG=y
CONFIG_UNIX=y
CONFIG_INET=y
CONFIG_IP_MULTICAST=y
CONFIG_IP_PNP=y
CONFIG_NET_SCHED=y
CONFIG_DEVTMPFS=y
CONFIG_DEVTMPFS_MOUNT=y
CONFIG_BLK_DEV_SD=y
CONFIG_CHR_DEV_SG=y
CONFIG_CVITEK_PINCTRL_CV1835=y
CONFIG_PREEMPT=y

#
# NETWORK
#
CONFIG_NETDEVICES=y
CONFIG_ETHERNET=y
CONFIG_NET_VENDOR_STMICRO=y
CONFIG_STMMAC_ETH=y
CONFIG_STMMAC_PLATFORM=y
CONFIG_DWMAC_CVITEK=y
# CONFIG_NET_VENDOR_CVITEK is not set
CONFIG_REALTEK_PHY=y
CONFIG_SMSC_PHY=y
CONFIG_CVITEK_PHY=y
CONFIG_CVITEK_PHY_UAPS=y
# CONFIG_FIXED_PHY is not set
CONFIG_VLAN_8021Q=y
CONFIG_MACVLAN=y
CONFIG_BRIDGE=y

#
# FILE SYSTEM
#
CONFIG_HW_RANDOM=y
CONFIG_RTC_CLASS=y
CONFIG_EXT4_FS=y
CONFIG_EXT4_ENCRYPTION=y
CONFIG_EXT4_FS_ENCRYPTION=y
CONFIG_TMPFS=y
CONFIG_NFS_FS=y
CONFIG_ROOT_NFS=y
CONFIG_PRINTK_TIME=y
CONFIG_BLK_DEV_INITRD=y
CONFIG_SQUASHFS=y
CONFIG_SQUASHFS_LZ4=y
CONFIG_SQUASHFS_LZO=y
CONFIG_SQUASHFS_XZ=y
CONFIG_SQUASHFS_ZLIB=y
CONFIG_ENABLE_DEFAULT_TRACERS=y
CONFIG_FAT_FS=y
CONFIG_MSDOS_FS=y
CONFIG_VFAT_FS=y
CONFIG_FAT_DEFAULT_CODEPAGE=437
CONFIG_FAT_DEFAULT_IOCHARSET="iso8859-1"
CONFIG_PSTORE=y
CONFIG_PSTORE_ZLIB_COMPRESS=y
CONFIG_PSTORE_CONSOLE=y
CONFIG_PSTORE_PMSG=y
CONFIG_PSTORE_FTRACE=y
CONFIG_PSTORE_RAM=y

#
# STORAGE : SD/EMMC/NAND/NOR
#
CONFIG_MMC=y
CONFIG_MMC_BLOCK=y
CONFIG_MMC_BLOCK_MINORS=8
CONFIG_MMC_SDHCI=y
CONFIG_MMC_SDHCI_PLTFM=y
CONFIG_MMC_SDHCI_CVI=y
CONFIG_MTD=y
CONFIG_MTD_CHAR=y
CONFIG_MTD_BLOCK=y
CONFIG_MTD_NAND=y
CONFIG_MTD_NAND_IDS=y
CONFIG_MTD_NAND_PLATFORM=y
CONFIG_MTD_NAND_CVSNFC=y
CONFIG_MTD_NAND_CVSNFC_DT=y
CONFIG_MTD_CMDLINE_PARTS=y
CONFIG_MTD_TEST=m
CONFIG_MTD_UBI=y
CONFIG_UBIFS_FS=y
CONFIG_MTD_UBI_BLOCK=y
CONFIG_SPI=y
CONFIG_MTD_SPI_NOR=y
CONFIG_SPI_CVI_SPIF=y
CONFIG_JFFS2_FS=y
CONFIG_JFFS2_FS_WBUF_VERIFY=y
CONFIG_JFFS2_SUMMARY=y
CONFIG_JFFS2_FS_XATTR=y
CONFIG_JFFS2_COMPRESSION_OPTIONS=y
CONFIG_JFFS2_LZO=y
CONFIG_JFFS2_RUBIN=y


#
# USB
#
CONFIG_CMA=y
CONFIG_DMA_CMA=y
CONFIG_USB=y
CONFIG_USB_CVITEK_GADGET=m
CONFIG_USB_GADGET=y
CONFIG_U_SERIAL_CONSOLE=y
CONFIG_USB_CONFIGFS=m
CONFIG_USB_CONFIGFS_SERIAL=y
CONFIG_USB_CONFIGFS_ACM=y
CONFIG_USB_CONFIGFS_MASS_STORAGE=y
CONFIG_USB_CONFIGFS_RNDIS=y
CONFIG_USB_CONFIGFS_EEM=y
CONFIG_USB_CONFIGFS_ECM=y
CONFIG_USB_CONFIGFS_F_UVC=y
CONFIG_USB_CONFIGFS_F_UAC1=y
# CONFIG_USB_CONFIGFS_F_LB_SS is not set
# CONFIG_USB_CONFIGFS_F_FS is not set
# CONFIG_USB_G_SERIAL is not set
# CONFIG_USB_CONFIGFS_BCM is not set
CONFIG_USB_CONFIGFS_CVG=y
# usb otg
CONFIG_USB_OTG=y
CONFIG_USB_OTG_FSM=y
CONFIG_USB_CVITEK_DRD=m
# usb host storage
CONFIG_USB_XHCI_HCD=y
CONFIG_USB_XHCI_PLATFORM=y
CONFIG_SCSI=y
CONFIG_USB_STORAGE=y
#CONFIG_USB_STORAGE_DEBUG=y
CONFIG_USB_STORAGE_REALTEK=y
CONFIG_USB_STORAGE_DATAFAB=y
CONFIG_USB_STORAGE_FREECOM=y
CONFIG_USB_STORAGE_ISD200=y
CONFIG_USB_STORAGE_USBAT=y
CONFIG_USB_STORAGE_SDDR09=y
CONFIG_USB_STORAGE_SDDR55=y
CONFIG_USB_STORAGE_JUMPSHOT=y
CONFIG_USB_STORAGE_ALAUDA=y
CONFIG_USB_STORAGE_ONETOUCH=y
CONFIG_USB_STORAGE_KARMA=y
CONFIG_USB_STORAGE_CYPRESS_ATACB=y
CONFIG_USB_STORAGE_ENE_UB6250=y
CONFIG_USB_UAS=y
CONFIG_BLK_DEV_LOOP=y
CONFIG_EFIVAR_FS=n
CONFIG_CRYPTO_HW=n
CONFIG_CRYPTO_ECHAINIV=n
CONFIG_KEXEC=y
CONFIG_CRASH_DUMP=y
CONFIG_MAGIC_SYSRQ=y
CONFIG_NLS=y
CONFIG_NLS_DEFAULT="iso8859-1"
CONFIG_NLS_CODEPAGE_437=y
CONFIG_NLS_CODEPAGE_850=y
CONFIG_NLS_ISO8859_1=y
CONFIG_NLS_ISO8859_2=y
CONFIG_NLS_ISO8859_3=y
CONFIG_NLS_UTF8=y
CONFIG_CVITEK_NPU=y
CONFIG_RESET_CONTROLLER=y
CONFIG_RESET_CVITEK=y
CONFIG_DMADEVICES=y
CONFIG_DMA_ENGINE=y
CONFIG_DMA_OF=y
CONFIG_DW_DMAC_CVITEK=y

#
# AUDIO
#
CONFIG_SOUND=y
CONFIG_SND=y
CONFIG_SND_SOC=y
CONFIG_SND_CV1835_I2S=y
CONFIG_CV1835_I2S_SUBSYS=y
#CONFIG_SND_SOC_CV1835_CONCURRENT_I2S=y
CONFIG_SND_SOC_CV1835_USE_AUDIO_PLL=y
#CONFIG_SND_CV1835_I2S_MCLK_OUTPUT_EN=y


#
# AUDIO - ADAU1372 CODEC
#
#CONFIG_SND_SOC_ADAU1372=y
#CONFIG_SND_SOC_ADAU_UTILS=y
#CONFIG_SND_SOC_ADAU1372_I2C=y
#CONFIG_SND_SOC_CV1835_ADAU1372=y

#
# AUDIO - PDM
#
#CONFIG_SND_SOC_CV1835_CV1835PDM=y
#CONFIG_SND_SOC_CV1835PDM=y

#
# AUDIO - INTERNAL ADC AND DAC
#
CONFIG_SND_SOC_CV1835_CV1835ADC=y
CONFIG_SND_SOC_CV1835ADC=y
CONFIG_SND_SOC_CV1835_CV1835DAC=y
CONFIG_SND_SOC_CV1835DAC=y

#
# SPI drivers
#
# CONFIG_SPI is not set
# CONFIG_SPI_MASTER is not set
# CONFIG_SPI_DESIGNWARE is not set
# CONFIG_SPI_DW_MMIO is not set
# CONFIG_SPI_SPIDEV is not set

#
# VIDEO
#
# media/v4l2 support
CONFIG_I2C_MUX=y
CONFIG_MEDIA_CONTROLLER=y
CONFIG_MEDIA_SUPPORT=y
CONFIG_MEDIA_CAMERA_SUPPORT=y
CONFIG_VIDEO_DEV=y
CONFIG_VIDEO_V4L2=y
CONFIG_V4L2_MEM2MEM_DEV=y
CONFIG_V4L_PLATFORM_DRIVERS=y
CONFIG_SOC_CAMERA=y
CONFIG_VIDEO_V4L2_SUBDEV_API=y
CONFIG_MEDIA_USB_SUPPORT=y
CONFIG_V4L_MEM2MEM_DRIVERS=y
CONFIG_VIDEO_CVITEK=m
CONFIG_VIDEO_CVITEK_CIF=m
CONFIG_VIDEO_CVITEK_SNS_I2C=m
CONFIG_VIDEO_CVITEK_MIPI_TX=m

#
# Frame buffer Devices
#
CONFIG_FB=y
CONFIG_FB_CVITEK=m

#
# PM Suspend
#
CONFIG_PM_DEBUG=y
CONFIG_PM_TEST_SUSPEND=y
CONFIG_PM_ADVANCED_DEBUG=y

#
# PERIPHERAL
#
CONFIG_PWM=y
CONFIG_PWM_CVITEK=m
CONFIG_WATCHDOG=y
CONFIG_DW_WATCHDOG=m
CONFIG_I2C=y
CONFIG_I2C_CHARDEV=y
CONFIG_I2C_DESIGNWARE_CORE=y
CONFIG_I2C_DESIGNWARE_PLATFORM=y
CONFIG_SERIAL_8250=y
CONFIG_SERIAL_8250_CONSOLE=y
CONFIG_SERIAL_8250_DW=y
CONFIG_SERIAL_8250_NR_UARTS=5
CONFIG_SERIAL_8250_RUNTIME_UARTS=5
CONFIG_GPIOLIB=y
CONFIG_GPIO_SYSFS=y
CONFIG_GPIO_DWAPB=y
CONFIG_INPUT_EVDEV=y

#
# SYSTEM
#
CONFIG_TEE=y
CONFIG_OPTEE=y
CONFIG_STAGING=y
CONFIG_ANDROID=y
CONFIG_ION=y
CONFIG_ION_CARVEOUT_HEAP=y
CONFIG_ION_SYSTEM_HEAP=y
CONFIG_ION_CMA_HEAP=y

#
# KGDB/ FTRACE
#
CONFIG_HAVE_ARCH_KGDB=y
CONFIG_KGDB=y
CONFIG_KGDB_SERIAL_CONSOLE=y
CONFIG_TRACING=y
CONFIG_EVENT_TRACING=y
CONFIG_TRACING_SUPPORT=y
CONFIG_CONTEXT_SWITCH_TRACER=y
CONFIG_GENERIC_TRACER=y
CONFIG_NOP_TRACER=y
CONFIG_HAVE_FUNCTION_TRACER=y
CONFIG_HAVE_FUNCTION_GRAPH_TRACER=y
CONFIG_HAVE_DYNAMIC_FTRACE=y
CONFIG_HAVE_FTRACE_MCOUNT_RECORD=y
CONFIG_HAVE_SYSCALL_TRACEPOINTS=y
CONFIG_HAVE_C_RECORDMCOUNT=y
CONFIG_TRACER_MAX_TRACE=y
CONFIG_TRACE_CLOCK=y
CONFIG_FTRACE=y
CONFIG_FUNCTION_TRACER=y
CONFIG_FUNCTION_GRAPH_TRACER=y
CONFIG_IRQSOFF_TRACER=y
CONFIG_SCHED_TRACER=y
CONFIG_HWLAT_TRACER=y
CONFIG_FTRACE_SYSCALLS=y
CONFIG_TRACER_SNAPSHOT=y
CONFIG_TRACER_SNAPSHOT_PER_CPU_SWAP=y
CONFIG_BRANCH_PROFILE_NONE=y
CONFIG_STACK_TRACER=y
CONFIG_BLK_DEV_IO_TRACE=y
CONFIG_DYNAMIC_FTRACE=y
CONFIG_FUNCTION_PROFILER=y
CONFIG_FTRACE_MCOUNT_RECORD=y

#
# Debug
#
CONFIG_DYNAMIC_DEBUG=y
CONFIG_DEBUG_KERNEL=y
CONFIG_DEBUG_INFO=y
CONFIG_DEBUG_STACKOVERFLOW=y
CONFIG_DEBUG_STACK_USAGE=y
CONFIG_SLUB_DEBUG=y
CONFIG_DEBUG_SPINLOCK=y
CONFIG_DEBUG_MUTEXES=y
CONFIG_DEBUG_ATOMIC_SLEEP=y
CONFIG_DEBUG_LIST=y
CONFIG_SCHEDSTATS=y
CONFIG_SCHED_STACK_END_CHECK=y
CONFIG_FRAME_POINTER=y

#
# WiFi
#
CONFIG_WLAN=y
CONFIG_CFG80211=y
CONFIG_CFG80211_DEFAULT_PS=y
CONFIG_CFG80211_CRDA_SUPPORT=y
CONFIG_CFG80211_WEXT=y
CONFIG_MAC80211=y
CONFIG_MAC80211_HAS_RC=y
CONFIG_MAC80211_RC_MINSTREL=y
CONFIG_MAC80211_RC_MINSTREL_HT=y
CONFIG_MAC80211_RC_DEFAULT_MINSTREL=y
CONFIG_MAC80211_RC_DEFAULT="minstrel_ht"

#
# Clock framework
#
CONFIG_COMMON_CLK=y
CONFIG_COMMON_CLK_CVITEK=y

#
# Thermal
#
CONFIG_THERMAL=y
CONFIG_THERMAL_WRITABLE_TRIPS=y
CONFIG_THERMAL_EMULATION=y
CONFIG_CV1835_THERMAL=y

#
# OTHERS
#
CONFIG_HW_PERF_EVENTS=y
CONFIG_RCU_CPU_STALL_TIMEOUT=21
CONFIG_RING_BUFFER=y
CONFIG_RING_BUFFER_ALLOW_SWAP=y
CONFIG_CONSOLE_POLL=y
CONFIG_CV1835_SYSDMA_REMAP=y
CONFIG_OVERLAY_FS=y
```

## linux_5.10/arch/riscv/mach-cvitek/Kconfig
```kconfig
config ARCH_CVITEK
    bool "Cvitek SoC Family"
	select ION_CVITEK
	select SCHED_CVITEK
	help
      This enables support for Cvitek SoC family.

if ARCH_CVITEK
choice
	prompt "Select the chip of SoC"
	default ARCH_CV181X
	help
	  Select the chip for SoC

config ARCH_CV181X
	bool "Cvitek CV181X SoC"
	help
	  This enables support for Cvitek's CV181X

config ARCH_CV180X
	bool "Cvitek CV180X SoC"
	help
	  This enables support for Cvitek's CV180X

endchoice

if ARCH_CV181X
config ARCH_CVITEK_CHIP
	string "cv181x"
	help
	  This enables support for Cvitek CV181X series

choice
	prompt "Select the platform of SoC"
	default ARCH_CV181X_FPGA
	help
	  Select the platform of SoC
	    FPGA
	    PALLADIUM
	    ASIC

config ARCH_CV181X_PALLADIUM
	bool "Cvitek CV181X SoC - Palladium"
	help
	  This enables support for Cvitek's CV181X SoC on Palladium platform

config ARCH_CV181X_FPGA
	bool "Cvitek CV181X SoC - FPGA"
	help
	  This enables support for Cvitek's CV181X SoC on FPGA platform

config ARCH_CV181X_ASIC
	bool "Cvitek CV181X SoC- ASIC"
	help
	  This enables support for Cvitek's CV181X SoC ASIC

endchoice
endif # end ARCH_CV181X

if ARCH_CV180X
config ARCH_CVITEK_CHIP
	string "cv180x"
	help
	  This enables support for Cvitek CV180X series

choice
	prompt "Select the platform of SoC"
	default ARCH_CV180X_FPGA
	help
	  Select the platform of SoC
	    FPGA
	    PALLADIUM
	    ASIC

config ARCH_CV180X_PALLADIUM
	bool "Cvitek CV180X SoC - Palladium"
	help
	  This enables support for Cvitek's CV180X SoC on Palladium platform

config ARCH_CV180X_FPGA
	bool "Cvitek CV180X SoC - FPGA"
	help
	  This enables support for Cvitek's CV180X SoC on FPGA platform

config ARCH_CV180X_ASIC
	bool "Cvitek CV180X SoC- ASIC"
	help
	  This enables support for Cvitek's CV180X SoC ASIC

endchoice
endif # end ARCH_CV181X

endif # end ARCH_CVITEK
```

## linux_5.10/drivers/clk/cvitek/Kconfig
```kconfig
config COMMON_CLK_CVITEK
    bool "Clock driver for CVITEK SoC Family"
    depends on ARCH_CVITEK || COMPILE_TEST
    default ARCH_CVITEK
    help
       Support the clocks on CVITEK SoC Family.

config COMMON_CLK_CV1832_TPU_500M
	bool "Set TPU clock to 500MHz for CV1832"
	depends on COMMON_CLK_CVITEK
	help
	  Set TPU clock to 500MHz for CV1832.
```

## linux_5.10/drivers/dma/cvitek/Kconfig
```kconfig
config DW_DMAC_CVITEK
        bool "cvitek dma engine based DW DMAC"
        select DMA_ENGINE
        help
          Support the DMA engine for cvitek platform devices.
```

## linux_5.10/drivers/efuse/Kconfig
```kconfig
# SPDX-License-Identifier: GPL-2.0-only
#
# Generic efuse drivers configuration
#

menuconfig EFUSE
	bool "Efuse drivers"
	default y
	help
		Efuse drivers offer a generic mechanism for
		efuse management.
		Only support cv181x and cv180x currently
		Efuse driver build-in is better

if EFUSE

config CV181X_EFUSE
	tristate "Efuse driver for CVITEK CV181X"
	depends on ARCH_CV181X || COMPILE_TEST
	default y
	help
		Select this driver for CVITEK CV181X efuse
		This driver is used for program and read efuse
		This driver can also be built as a module
		But build-in is better.

config CV180X_EFUSE
	tristate "Efuse driver for CVITEK CV180X"
	depends on ARCH_CV180X || COMPILE_TEST
	default y
	help
		Select this driver for CVITEK CV180X efuse op
		This driver is used for program and read efuse
		This driver can also be built as a module
                But build-in is better.

endif
```

## linux_5.10/drivers/media/platform/cvitek/Kconfig
```kconfig
config VIDEO_CVITEK_CIF
	tristate "CVITEK CIF driver"
	depends on HAS_DMA
	default y
	help
	  This is a V4L2 driver for the CVITEK camera interface.

	  To compile this driver as a module, choose M here: the
	  module will be called mipi_rx.

config VIDEO_CVITEK_SNS_I2C
	tristate "CVITEK Sensor I2C driver"
	depends on HAS_DMA
	default y
	help
	This is a V4L2 driver for the CVITEK Sensor I2C Wrapper.

	To compile this driver as a module, choose M here: the
	module will be called sensor_i2c.
```

## linux_5.10/drivers/net/wireless/aicsemi/Kconfig
```kconfig
config WLAN_VENDOR_AICSEMI
	bool "AICSEMI devices"
	default y
	help
	  If you have a wireless card belonging to this class, say Y.

	  Note that the answer to this question doesn't directly affect the
	  kernel: saying N will just cause the configurator to skip all the
	  questions about these cards. If you say Y, you will be asked for
	  your specific card in the following questions.

if WLAN_VENDOR_AICSEMI

source "drivers/net/wireless/aicsemi/aic8800/Kconfig"

endif # WLAN_VENDOR_AICSEMI
```

## linux_5.10/drivers/net/wireless/aicsemi/aic8800/Kconfig
```kconfig
config AIC8800
	bool "AIC wireless Support"
	default n
	help
	  This is support for aic wireless chip.

config AIC_FW_PATH
	depends on AIC8800
	string "Firmware & config file path"
	default "/vendor/etc/firmware"
	#default "/lib/firmware/aic8800_sdio"
	help
	  Path to the firmware & config file.

if AIC8800
source "drivers/net/wireless/aicsemi/aic8800/aic8800_fdrv/Kconfig"
source "drivers/net/wireless/aicsemi/aic8800/aic8800_btlpm/Kconfig"
endif
```

## linux_5.10/drivers/net/wireless/icommsemi/Kconfig
```kconfig
# SPDX-License-Identifier: GPL-2.0-only
config WLAN_VENDOR_ICOMMSEMI
	bool "ICOMMSEMI devices"
	default y
	help
	  If you have a wireless card belonging to this class, say Y.

	  Note that the answer to this question doesn't directly affect the
	  kernel: saying N will just cause the configurator to skip all the
	  questions about these cards. If you say Y, you will be asked for
	  your specific card in the following questions.

if WLAN_VENDOR_ICOMMSEMI

config SV6115
    tristate "ICOMMSEMI SV6115 USB WiFi"
    help
      This chip work through USB.
      You need to say Y if your board use this chip to implement wifi

endif # WLAN_VENDOR_ICOMMSEMI
```
