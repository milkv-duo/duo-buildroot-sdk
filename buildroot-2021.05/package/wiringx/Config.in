## linux_5.10/Documentation/devicetree/bindings/clock/cvitek,cv181x-clk.yaml
```yaml
# SPDX-License-Identifier: (GPL-2.0-only OR BSD-2-Clause)
%YAML 1.2
---
$id: http://devicetree.org/schemas/clock/cvitek,cv181x-clk.yaml#
$schema: http://devicetree.org/meta-schemas/core.yaml#

title: Cvitek CV181X SoC Clock Controller

maintainers:
  - Fisher Cheng <fisher.cheng@cvitek.com>

description: |
  The Cvitek CV181X SoC clock controller generates and supplies clock to
  various peripherals within the SoC.

  This binding uses common clock bindings
  [1] Documentation/devicetree/bindings/clock/clock-bindings.txt

properties:
  compatible:
    const: cvitek,cv181x-clk

  reg:
    maxItems: 1

  clocks:
    maxItems: 1

  '#clock-cells':
    const: 1

required:
  - compatible
  - reg
  - clocks
  - '#clock-cells'

additionalProperties: false

examples:
  # Clock controller node:
  - |
    clk: clock-controller {
      compatible = "cvitek,cv181x-clk";
      reg = <0x0 0x03002000 0x0 0x1000>;
      clocks = <&osc>;
      #clock-cells = <1>;
    };

  # Example PWM controller node that consumes clock generated by the clock controller:
  - |
    pwm0: pwm@3060000 {
      compatible = "cvitek,cvi-pwm";
      reg = <0x0 0x3060000 0x0 0x1000>;
      clocks = <&clk CV181X_CLK_PWM>;
      #pwm-cells = <1>;
    };

...
```

## linux_5.10/Documentation/devicetree/bindings/soc/cvitek/base.txt
```
Cvitek base driver

This document describes the binding for the Cvitek base.

Required properties:
- compatible: "cvitek,base"
```

## linux_5.10/Documentation/devicetree/bindings/soc/cvitek/bt_pin.txt
```
Cvitek bluetooth pin driver

Required properties:
- compatible: "cvitek,bt-pin"
- power-gpio: bluetooth chip power on gpio
```

## linux_5.10/Documentation/devicetree/bindings/soc/cvitek/cif.txt
```
Cvitek cif driver

This document describes the binding for the Cvitek cif.

Required properties:
- compatible: "cvitek,cif"
- reg: cif register regions
- interrupts: cif interrupt number
```

## linux_5.10/Documentation/devicetree/bindings/soc/cvitek/fb.txt
```
Cvitek fb driver

This document describes the binding for the Cvitek fb.

Required properties:
- compatible: "cvitek,fb"
- reg: fb register regions
- interrupts: display interrupt number
```

## linux_5.10/Documentation/devicetree/bindings/soc/cvitek/jpu.txt
```
Cvitek JPEG Driver

This document describes the binding for Cvitek JPEG.

Required properties:
- compatible: "cvitek,jpeg"
- reg: jpu register regions
- interrupts: jpu interrupt number
```

## linux_5.10/Documentation/devicetree/bindings/soc/cvitek/saradc.txt
```
Cvitek saradc driver

This document describes the binding for the Cvitek saradc.

Required properties:
- compatible: "cvitek,saradc"
- reg: saradc register regions
- interrupts: saradc interrupt number
```

## linux_5.10/Documentation/devicetree/bindings/soc/cvitek/vcodec.txt
```
Cvitek Video Codec Driver

This document describes the binding for Cvitek Video Codec.

Required properties:
- compatible: should be one of the following
  - "cvitek,vcodec"
  - "cvitek,cv1822-fpga-vcodec"
  - "cvitek,cv1822-fpga-jpeg"
- reg: vcodec register regions
- interrupts: vcodec interrupt number
```

## linux_5.10/Documentation/devicetree/bindings/soc/cvitek/vip.txt
```
Cvitek vip driver

This document describes the binding for the Cvitek vip.

Required properties:
- compatible: "cvitek,vip"
- reg: vip register regions
- interrupts: vip interrupt number
```

## linux_5.10/Documentation/devicetree/bindings/soc/cvitek/wiegand.txt
```
Cvitek wiegand driver

This document describes the binding for the Cvitek vip.

Required properties:
- compatible: "cvitek,wiegand"
- reg: wiegand register regions
- interrupts: wiegand interrupt number
```

## linux_5.10/Documentation/devicetree/bindings/soc/cvitek/wifi_pin.txt
```
sCvitek wifi pin driver

Required properties:
- compatible: "cvitek,wifi-pin"
- power-gpio: Wifi chip power on gpio
- wakeup-gpio: Wifi chip wakeup gpio
```

## linux_5.10/Documentation/devicetree/bindings/thermal/cvitek-cv180x-thermal.txt
```
* CVITEK CV180X Thermal Driver

** Required properties:
- compatible : "cvitek,cv180x-thermal"
- reg : Address range of the thermal registers.
- interrupts : Should contain interrupt for thermal system.
- clocks : The clocks for thermal(tempsen).
- clock-names : Should be "clk_tempsen".
- #thermal-sensor-cells : Should be <1>.
```

## linux_5.10/Documentation/devicetree/bindings/thermal/cvitek-cv181x-thermal.txt
```
* CVITEK CV181X Thermal Driver

** Required properties:
- compatible : "cvitek,cv181x-thermal"
- reg : Address range of the thermal registers.
- interrupts : Should contain interrupt for thermal system.
- clocks : The clocks for thermal(tempsen).
- clock-names : Should be "clk_tempsen".
- #thermal-sensor-cells : Should be <1>.
```

## linux_5.10/arch/arm/mach-cvitek/Kconfig
```kconfig
config ARCH_CVITEK
    bool "Cvitek SoC Family"
	select ION_CVITEK
	select SCHED_CVITEK
	help
      This enables support for Cvitek SoC family.

if ARCH_CVITEK
choice
	prompt "Select the chip of SoC"
	default ARCH_CV1835
	help
	  Select the chip for SoC

config ARCH_CV1835
	bool "Cvitek CV1835 SoC"
	select PINCTRL
	select PINCTRL_BM
	select PINMUX
	select PINCONF
	select GENERIC_PINCONF
	help
	  This enables support for Cvitek's CV1835

config ARCH_CV182X
	bool "Cvitek CV182X SoC"
	select PINCTRL
	select PINCTRL_BM
	select PINMUX
	select PINCONF
	select GENERIC_PINCONF
    select ARM_GIC
    select ARM_AMBA
    select ARM_GIC_V3
	help
	  This enables support for Cvitek's CV1822

config ARCH_CV181X
	bool "Cvitek CV181X SoC"
	select PINCTRL
	select PINCTRL_BM
	select PINMUX
	select PINCONF
	select GENERIC_PINCONF
    select ARM_GIC
    select ARM_AMBA
    select ARM_GIC_V3
	help
	  This enables support for Cvitek's CV181X

endchoice

if ARCH_CV1835
choice
	prompt "Select the platform of SoC"
	default ARCH_CV1835_FPGA
	help
	  Select the platform of SoC

config ARCH_CV1835_PALLADIUM
	bool "Cvitek CV1835 SoC - Palladium"
	help
	  This enables support for Cvitek's CV1835 SoC on Palladium platform

config ARCH_CV1835_FPGA
	bool "Cvitek CV1835 SoC - FPGA"
	help
	  This enables support for Cvitek's CV1835 SoC on FPGA platform

config ARCH_CV1835_ASIC
	bool "Cvitek CV1835 SoC- ASIC"
	help
	  This enables support for Cvitek's CV1835 SoC ASIC

endchoice

endif # end ARCH_CV1835

if ARCH_CV1822
choice
	prompt "Select the platform of SoC"
	default ARCH_CV1822_FPGA
	help
	  Select the platform of SoC

config ARCH_CV1822_PALLADIUM
	bool "Cvitek CV1822 SoC - Palladium"
	help
	  This enables support for Cvitek's CV1822 SoC on Palladium platform

config ARCH_CV1822_FPGA
	bool "Cvitek CV1822 SoC - FPGA"
	help
	  This enables support for Cvitek's CV1822 SoC on FPGA platform

config ARCH_CV1822_ASIC
	bool "Cvitek CV1822 SoC- ASIC"
	help
	  This enables support for Cvitek's CV1822 SoC ASIC

endchoice

endif # end ARCH_CV1822

if ARCH_CV182X
config ARCH_CVITEK_CHIP
	string "cv182x"
	help
	  This enables support for Cvitek CV182X series

choice
	prompt "Select the platform of SoC"
	default ARCH_CV182X_FPGA
	help
	  Select the platform of SoC

config ARCH_CV182X_PALLADIUM
	bool "Cvitek CV182X SoC - Palladium"
	help
	  This enables support for Cvitek's CV182X SoC on Palladium platform

config ARCH_CV182X_FPGA
	bool "Cvitek CV182X SoC - FPGA"
	help
	  This enables support for Cvitek's CV182X SoC on FPGA platform

config ARCH_CV182X_ASIC
	bool "Cvitek CV182X SoC- ASIC"
	help
	  This enables support for Cvitek's CV182X SoC ASIC

endchoice
endif # end ARCH_CV182X

if ARCH_CV183X
config ARCH_CVITEK_CHIP
	string "cv183x"
	help
	  This enables support for Cvitek CV183X series

choice
	prompt "Select the platform of SoC"
	default ARCH_CV183X_ASIC
	help
	  Select the platform of SoC

config ARCH_CV183X_PALLADIUM
	bool "Cvitek CV183X SoC - Palladium"
	help
	  This enables support for Cvitek's CV183X SoC on Palladium platform

config ARCH_CV183X_FPGA
	bool "Cvitek CV183X SoC - FPGA"
	help
	  This enables support for Cvitek's CV183X SoC on FPGA platform

config ARCH_CV183X_ASIC
	bool "Cvitek CV183X SoC- ASIC"
	help
	  This enables support for Cvitek's CV183X SoC ASIC
endchoice

endif # end ARCH_CV183X

if ARCH_CV181X
config ARCH_CVITEK_CHIP
	string "cv181x"
	help
	  This enables support for Cvitek CV181X series

choice
	prompt "Select the platform of SoC"
	default ARCH_CV181X_FPGA
	help
	  Select the platform of SoC
	    FPGA
	    PALLADIUM
	    ASIC

config ARCH_CV181X_PALLADIUM
	bool "Cvitek CV181X SoC - Palladium"
	help
	  This enables support for Cvitek's CV181X SoC on Palladium platform

config ARCH_CV181X_FPGA
	bool "Cvitek CV182X SoC - FPGA"
	help
	  This enables support for Cvitek's CV181X SoC on FPGA platform

config ARCH_CV181X_ASIC
	bool "Cvitek CV181X SoC- ASIC"
	help
	  This enables support for Cvitek's CV181X SoC ASIC

endchoice
endif # end ARCH_CV181X

endif # end ARCH_CVITEK
```

## linux_5.10/arch/arm64/configs/cvitek_cv1822_fpga_defconfig
```kconfig
CONFIG_SYSVIPC=y
CONFIG_POSIX_MQUEUE=y
CONFIG_FHANDLE=y
CONFIG_NO_HZ_IDLE=y
CONFIG_HIGH_RES_TIMERS=y
CONFIG_TASKSTATS=y
CONFIG_SCHED_AUTOGROUP=y
CONFIG_PROFILING=y
CONFIG_MODULES=y
CONFIG_MODULE_UNLOAD=y
CONFIG_MODULE_FORCE_LOAD=y
CONFIG_MODULE_FORCE_UNLOAD=y
CONFIG_BLK_DEV_BSGLIB=y
CONFIG_ARCH_CVITEK=y
CONFIG_ARCH_CVITEK_CHIP="cv182x"
CONFIG_ARCH_CV182X=y
CONFIG_ARCH_CV182X_FPGA=y
# CONFIG_SMP is not set
CONFIG_TRANSPARENT_HUGEPAGE=y
CONFIG_COMPAT=y
CONFIG_NET=y
CONFIG_PACKET=y
CONFIG_PACKET_DIAG=y
CONFIG_UNIX=y
CONFIG_INET=y
CONFIG_IP_MULTICAST=y
CONFIG_IP_PNP=y
CONFIG_NET_SCHED=y
CONFIG_DEVTMPFS=y
CONFIG_DEVTMPFS_MOUNT=y
CONFIG_BLK_DEV_SD=y
CONFIG_CHR_DEV_SG=y
CONFIG_CVITEK_PINCTRL_CV1835=y

# Network drivers
CONFIG_NETDEVICES=y
CONFIG_ETHERNET=y
CONFIG_NET_VENDOR_STMICRO=y
CONFIG_STMMAC_ETH=y
CONFIG_STMMAC_PLATFORM=y
CONFIG_DWMAC_CVITEK=y
CONFIG_SMSC_PHY=y
# CONFIG_FIXED_PHY is not set
CONFIG_VLAN_8021Q=y
CONFIG_MACVLAN=y

CONFIG_SERIAL_8250=y
CONFIG_SERIAL_8250_CONSOLE=y
CONFIG_SERIAL_8250_DW=y
CONFIG_HW_RANDOM=y
CONFIG_RTC_CLASS=y
CONFIG_EXT4_FS=y
CONFIG_TMPFS=y
CONFIG_NFS_FS=y
CONFIG_ROOT_NFS=y
CONFIG_DEBUG_KERNEL=y
CONFIG_DEBUG_INFO=y
CONFIG_PRINTK_TIME=y
CONFIG_BLK_DEV_INITRD=y
CONFIG_SQUASHFS=y
CONFIG_SQUASHFS_LZ4=y
CONFIG_SQUASHFS_LZO=y
CONFIG_SQUASHFS_XZ=y
CONFIG_SQUASHFS_ZLIB=y
CONFIG_ENABLE_DEFAULT_TRACERS=y
CONFIG_GPIOLIB=y
CONFIG_GPIO_SYSFS=y
CONFIG_GPIO_DWAPB=y
CONFIG_MMC=y
CONFIG_MMC_BLOCK=y
CONFIG_MMC_BLOCK_MINORS=8
CONFIG_MMC_SDHCI=y
CONFIG_MMC_SDHCI_PLTFM=y
CONFIG_MMC_SDHCI_CVI=y
CONFIG_MTD=y
CONFIG_MTD_NAND=y
CONFIG_MTD_NAND_IDS=y
CONFIG_MTD_NAND_PLATFORM=y
CONFIG_MTD_NAND_HPNFC=y
CONFIG_MTD_NAND_HPNFC_DT=y
CONFIG_MTD_NAND_CVSNFC=y
CONFIG_MTD_NAND_CVSNFC_DT=y
CONFIG_MTD_CMDLINE_PARTS=y
CONFIG_CMA=y
CONFIG_DMA_CMA=y
CONFIG_USB=y
CONFIG_USB_GADGET=y
CONFIG_U_SERIAL_CONSOLE=y
CONFIG_USB_CONFIGFS=m
CONFIG_USB_CONFIGFS_SERIAL=y
CONFIG_USB_CONFIGFS_ACM=y
CONFIG_USB_CONFIGFS_MASS_STORAGE=y
CONFIG_USB_CONFIGFS_RNDIS=y
CONFIG_USB_CONFIGFS_EEM=y
CONFIG_USB_CONFIGFS_ECM=y
CONFIG_USB_CONFIGFS_F_UVC=y
CONFIG_USB_CONFIGFS_F_UAC1=y
# CONFIG_USB_CONFIGFS_F_LB_SS is not set
# CONFIG_USB_CONFIGFS_F_FS is not set
# CONFIG_USB_G_SERIAL is not set
# CONFIG_USB_CONFIGFS_BCM is not set
CONFIG_USB_CONFIGFS_CVG=y
# usb otg
CONFIG_USB_OTG=y
CONFIG_USB_OTG_FSM=y
CONFIG_USB_DWC2=m
CONFIG_USB_DWC2_DUAL_ROLE=m

# usb host storage
CONFIG_SCSI=y
CONFIG_USB_STORAGE=y
#CONFIG_USB_STORAGE_DEBUG=y
CONFIG_USB_STORAGE_REALTEK=y
CONFIG_USB_STORAGE_DATAFAB=y
CONFIG_USB_STORAGE_FREECOM=y
CONFIG_USB_STORAGE_ISD200=y
CONFIG_USB_STORAGE_USBAT=y
CONFIG_USB_STORAGE_SDDR09=y
CONFIG_USB_STORAGE_SDDR55=y
CONFIG_USB_STORAGE_JUMPSHOT=y
CONFIG_USB_STORAGE_ALAUDA=y
CONFIG_USB_STORAGE_ONETOUCH=y
CONFIG_USB_STORAGE_KARMA=y
CONFIG_USB_STORAGE_CYPRESS_ATACB=y
CONFIG_USB_STORAGE_ENE_UB6250=y
CONFIG_USB_UAS=y
CONFIG_BLK_DEV_LOOP=y

CONFIG_STAGING=y
CONFIG_ANDROID=y
CONFIG_ION=y
CONFIG_ION_CARVEOUT_HEAP=y
CONFIG_EFIVAR_FS=n
CONFIG_CRYPTO_HW=n
CONFIG_CRYPTO_ECHAINIV=n
# CONFIG_VPP_ENB is not set
CONFIG_I2C=y
CONFIG_I2C_CHARDEV=y
CONFIG_I2C_DESIGNWARE_CORE=y
CONFIG_I2C_DESIGNWARE_PLATFORM=y
CONFIG_KEXEC=y
CONFIG_CRASH_DUMP=y
CONFIG_MAGIC_SYSRQ=y
CONFIG_FAT_FS=y
CONFIG_MSDOS_FS=y
CONFIG_VFAT_FS=y
CONFIG_FAT_DEFAULT_CODEPAGE=437
CONFIG_FAT_DEFAULT_IOCHARSET="iso8859-1"
CONFIG_NLS=y
CONFIG_NLS_DEFAULT="iso8859-1"
CONFIG_NLS_CODEPAGE_437=y
CONFIG_NLS_CODEPAGE_850=y
CONFIG_NLS_ISO8859_1=y
CONFIG_NLS_ISO8859_2=y
CONFIG_NLS_ISO8859_3=y
CONFIG_NLS_UTF8=y
CONFIG_CVITEK_NPU=y
CONFIG_RESET_CONTROLLER=y
CONFIG_RESET_CVITEK=y
CONFIG_DMADEVICES=y
CONFIG_DMA_ENGINE=y
CONFIG_DMA_OF=y
CONFIG_DW_DMAC_CVITEK=y

# audio driver
#CONFIG_SOUND=y
#CONFIG_SND=y
#CONFIG_SND_SOC=y
#CONFIG_SND_SOC_ADAU1372=y
#CONFIG_SND_SOC_ADAU_UTILS=y
#CONFIG_SND_SOC_ADAU1372_I2C=y
#CONFIG_SND_CV1835_I2S=y
#CONFIG_SND_SOC_CV1835_ADAU1372=y
# CONFIG_SND_SOC_ADAU1372_SPI is not set
#CONFIG_SND_SOC_CV1835_CONCURRENT_I2S=y
#CONFIG_CV1835_I2S_SUBSYS=y
#CONFIG_SND_SOC_CV1835_USE_AUDIO_PLL=y
#CONFIG_SND_SOC_CV1835_CV1835PDM=y
#CONFIG_SND_SOC_CV1835PDM=y
#CONFIG_SND_SOC_CV1835_CV1835ADC=y
#CONFIG_SND_SOC_CV1835ADC=y
#CONFIG_SND_SOC_CV1835_CV1835DAC=y
#CONFIG_SND_SOC_CV1835DAC=y

CONFIG_MODVERSIONS=y
CONFIG_ION_CARVEOUT_HEAP=y
CONFIG_PWM=y
CONFIG_PWM_CVITEK=m
CONFIG_CONSOLE_POLL=y
CONFIG_HAVE_ARCH_KGDB=y
CONFIG_KGDB=y
CONFIG_KGDB_SERIAL_CONSOLE=y
CONFIG_DYNAMIC_DEBUG=y
CONFIG_HW_PERF_EVENTS=y
CONFIG_TEE=y
CONFIG_OPTEE=y
CONFIG_WATCHDOG=y
CONFIG_DW_WATCHDOG=m

#
# SPI drivers
#
# CONFIG_SPI is not set
# CONFIG_SPI_MASTER is not set
# CONFIG_SPI_DESIGNWARE is not set
# CONFIG_SPI_DW_MMIO is not set
# CONFIG_SPI_SPIDEV is not set

#
# VIDEO
#
# media/v4l2 support
CONFIG_I2C_MUX=y
CONFIG_MEDIA_CONTROLLER=y
CONFIG_MEDIA_SUPPORT=y
CONFIG_MEDIA_CAMERA_SUPPORT=y
CONFIG_VIDEO_DEV=y
CONFIG_VIDEO_V4L2=y
CONFIG_V4L2_MEM2MEM_DEV=y
CONFIG_V4L_PLATFORM_DRIVERS=y
CONFIG_SOC_CAMERA=y
CONFIG_VIDEO_V4L2_SUBDEV_API=y
CONFIG_MEDIA_USB_SUPPORT=y
CONFIG_V4L_MEM2MEM_DRIVERS=y
CONFIG_VIDEO_CVITEK=m
CONFIG_VIDEO_CVITEK_CIF=m
CONFIG_VIDEO_CVITEK_SNS_I2C=m
CONFIG_VIDEO_CVITEK_MIPI_TX=m

#
# Frame buffer Devices
#CONFIG_FB=y
#CONFIG_FB_CVITEK=m
```
