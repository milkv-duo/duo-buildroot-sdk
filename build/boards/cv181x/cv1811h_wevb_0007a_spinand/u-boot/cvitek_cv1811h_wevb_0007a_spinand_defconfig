## build/boards/cv182x/cv1820_wevb_0005b_spinor_alios/u-boot/cvitek_cv1820_wevb_0005b_spinor_alios_defconfig
```kconfig
CONFIG_CVI_BOOTLOADER=y
CONFIG_PARITION_NO_VERIFY=y
CONFIG_ARM=y
CONFIG_TARGET_CVITEK=y
CONFIG_TARGET_CVITEK_CV1822=y
CONFIG_SYS_MALLOC_F_LEN=0x400000
CONFIG_IDENT_STRING=" cvitek_cv1822"
CONFIG_ARMV8_SET_SMPEN=y
CONFIG_SYS_BOOTMAPSZ=0x04000000
CONFIG_DEFAULT_DEVICE_TREE="cv1822_asic"
# CONFIG_SYS_MALLOC_CLEAR_ON_INIT is not set
# CONFIG_ARCH_FIXUP_FDT_MEMORY is not set
CONFIG_BOOTDELAY=1
# CONFIG_DISPLAY_CPUINFO is not set
# CONFIG_DISPLAY_BOARDINFO is not set
# CONFIG_CMDLINE is not set
CONFIG_SYS_PROMPT="cv1822# "
# CONFIG_CMD_BDI is not set
# CONFIG_CMD_CONSOLE is not set
# CONFIG_CMD_BOOTD is not set
# CONFIG_CMD_BOOTM is not set
# CONFIG_CMD_BOOTI is not set
# CONFIG_CMD_ELF is not set
# CONFIG_CMD_GO is not set
# CONFIG_CMD_RUN is not set
# CONFIG_CMD_IMI is not set
# CONFIG_CMD_IMLS is not set
# CONFIG_CMD_XIMG is not set
# CONFIG_CMD_EXPORTENV is not set
# CONFIG_CMD_IMPORTENV is not set
# CONFIG_CMD_EDITENV is not set
# CONFIG_CMD_SAVEENV is not set
# CONFIG_CMD_ENV_EXISTS is not set
# CONFIG_CMD_MEMORY is not set
# CONFIG_CMD_CRC32 is not set
# CONFIG_CMD_DM is not set
# CONFIG_CMD_LOADB is not set
# CONFIG_CMD_LOADS is not set
# CONFIG_CMD_FLASH is not set
# CONFIG_CMD_FPGA is not set
# CONFIG_CMD_ECHO is not set
# CONFIG_CMD_ITEST is not set
# CONFIG_CMD_SOURCE is not set
# CONFIG_CMD_SETEXPR is not set
# CONFIG_CMD_NET is not set
# CONFIG_CMD_NFS is not set
# CONFIG_CMD_MISC is not set
# CONFIG_CMD_CVI_UPDATE is not set
# CONFIG_PARTITIONS is not set
CONFIG_OF_CONTROL=y
CONFIG_DM=y
# CONFIG_DM_DEVICE_REMOVE is not set
CONFIG_CLK=y
CONFIG_DM_GPIO=y
CONFIG_DWAPB_GPIO=y
# CONFIG_MMC is not set
CONFIG_SPI_FLASH=y
CONFIG_SYS_NS16550=y
CONFIG_DESIGNWARE_WATCHDOG=y
CONFIG_FS_FAT=y
# CONFIG_EFI_LOADER is not set
```

## build/boards/cv182x/cv1821_wevb_0005b_64mb_spinor/cv1821_wevb_0005b_64mb_spinor_defconfig
```kconfig
CONFIG_CUSTOMER="generic"
# CONFIG_CHIP_cv1832 is not set
# CONFIG_CHIP_cv1826 is not set
# CONFIG_CHIP_cv1835 is not set
CONFIG_CHIP_cv1821=y
# CONFIG_CHIP_cv1838 is not set
# CONFIG_CHIP_cv1829 is not set
# CONFIG_CHIP_cv9520 is not set
# CONFIG_CHIP_cv7581 is not set
# CONFIG_CHIP_cv1822 is not set
CONFIG_CHIP="cv1821"
CONFIG_BOARD_wevb_0005b_64mb_spinor=y
CONFIG_BOARD="wevb_0005b_64mb_spinor"
CONFIG_ARCH="arm64"

#
# Compile-time checks and compiler options
#
CONFIG_CROSS_COMPILE="aarch64-linux-gnu-"
CONFIG_CROSS_COMPILE_KERNEL="aarch64-linux-gnu-"
# CONFIG_CC_OPTIMIZE_FOR_PERFORMANCE=y
CONFIG_CC_OPTIMIZE_FOR_SIZE=y
CONFIG_FLASH_SIZE_SHRINK=y
CONFIG_BOOT_IMAGE_SINGLE_DTB=y
CONFIG_DDR_64MB_SIZE=y
CONFIG_STORAGE_TYPE_spinor=y
CONFIG_SENSOR_SMS_SC3335=y
CONFIG_SENSOR_GCORE_GC4653=y
CONFIG_SENSOR_SONY_IMX307=n
CONFIG_SENSOR_SONY_IMX327=n
CONFIG_SENSOR_TUNING_PARAM_cv182x_src_sony_imx307=y
CONFIG_MIPI_PANEL_2_LANES=y
CONFIG_MIPI_PANEL_LANE_SWAP=y
CONFIG_KERNEL_SRC_5.10=y
CONFIG_KERNEL_LZMA=y
CONFIG_SKIP_RAMDISK=y
CONFIG_CP_EXT_WIRELESS=y
# CONFIG_ROOTFS_OVERLAYFS is not set
CONFIG_TARGET_PACKAGE_DROPBEAR=y
CONFIG_TARGET_PACKAGE_BUSYBOX_SYSLOGD_SCRIPT=y
CONFIG_TARGET_PACKAGE_OPENSSL=y
CONFIG_TARGET_PACKAGE_WIFI=y
CONFIG_TARGET_PACKAGE_GDBSERVER=n
CONFIG_TARGET_PACKAGE_OTASERVER=n
CONFIG_TARGET_PACKAGE_RSYSLOG=n
CONFIG_TARGET_PACKAGE_SECURE_IMAGE=n
CONFIG_TARGET_PACKAGE_LIBCRYPTO=y
```
