## build/boards/cv183x/cv1835_palladium/linux/cvitek_cv1835_palladium_defconfig
```kconfig
CONFIG_SYSVIPC=y
CONFIG_POSIX_MQUEUE=y
CONFIG_FHANDLE=y
CONFIG_NO_HZ_IDLE=y
CONFIG_HIGH_RES_TIMERS=y
CONFIG_TASKSTATS=y
CONFIG_SCHED_AUTOGROUP=y
CONFIG_PROFILING=y
CONFIG_MODULES=y
CONFIG_MODULE_UNLOAD=y
CONFIG_BLK_DEV_BSGLIB=y
CONFIG_ARCH_CVITEK=y
CONFIG_ARCH_CVITEK_CHIP="cv183x"
CONFIG_ARCH_CV183X=y
CONFIG_ARCH_CV183X_PALLADIUM=y
CONFIG_SMP=y
CONFIG_TRANSPARENT_HUGEPAGE=y
CONFIG_COMPAT=y
CONFIG_NET=y
CONFIG_PACKET=y
CONFIG_PACKET_DIAG=y
CONFIG_UNIX=y
CONFIG_INET=y
CONFIG_IP_MULTICAST=y
CONFIG_IP_PNP=y
CONFIG_NET_SCHED=y
CONFIG_DEVTMPFS=y
CONFIG_DEVTMPFS_MOUNT=y
CONFIG_BLK_DEV_SD=y
CONFIG_CHR_DEV_SG=y

# Network drivers
#CONFIG_NETDEVICES=y
#CONFIG_ETHERNET=y
#CONFIG_NET_VENDOR_STMICRO=y
#CONFIG_STMMAC_ETH=y
#CONFIG_STMMAC_PLATFORM=y
#CONFIG_DWMAC_CVITEK=y
# CONFIG_NET_VENDOR_CVITEK is not set
# CONFIG_BROADCOM_PHY=y
# CONFIG_MARVELL_PHY=y
#CONFIG_REALTEK_PHY=y
#CONFIG_SMSC_PHY=y
#CONFIG_FIXED_PHY=y
# CONFIG_VLAN_8021Q is not set
# CONFIG_MACVLAN is not set

CONFIG_SERIAL_8250=y
CONFIG_SERIAL_8250_CONSOLE=y
CONFIG_SERIAL_8250_DW=y
CONFIG_HW_RANDOM=y
CONFIG_RTC_CLASS=y
CONFIG_EXT4_FS=y
CONFIG_TMPFS=y
CONFIG_NFS_FS=y
CONFIG_ROOT_NFS=y
CONFIG_DEBUG_KERNEL=y
CONFIG_DEBUG_INFO=y
CONFIG_PRINTK_TIME=y
CONFIG_BLK_DEV_INITRD=y
CONFIG_ENABLE_DEFAULT_TRACERS=y
CONFIG_GPIOLIB=y
CONFIG_GPIO_SYSFS=y
CONFIG_GPIO_DWAPB=y
#CONFIG_MMC=y
#CONFIG_MMC_BLOCK=y
#CONFIG_MMC_BLOCK_MINORS=8
#CONFIG_MMC_SDHCI=y
#CONFIG_MMC_SDHCI_PLTFM=y
#CONFIG_MMC_SDHCI_BM=y
CONFIG_CMA=y
CONFIG_DMA_CMA=y
CONFIG_STAGING=y
CONFIG_ANDROID=y
CONFIG_ION=y
CONFIG_EFIVAR_FS=n
CONFIG_CRYPTO_HW=n
CONFIG_CRYPTO_ECHAINIV=n
# CONFIG_VPP_ENB is not set
CONFIG_I2C=y
CONFIG_I2C_CHARDEV=y
CONFIG_I2C_DESIGNWARE_CORE=y
CONFIG_I2C_DESIGNWARE_PLATFORM=y
CONFIG_KEXEC=y
CONFIG_CRASH_DUMP=y
CONFIG_MAGIC_SYSRQ=y
CONFIG_FAT_FS=y
CONFIG_MSDOS_FS=y
CONFIG_VFAT_FS=y
CONFIG_FAT_DEFAULT_CODEPAGE=437
CONFIG_FAT_DEFAULT_IOCHARSET="iso8859-1"
#CONFIG_NLS=y
#CONFIG_NLS_DEFAULT="iso8859-1"
#CONFIG_NLS_CODEPAGE_437=y
#CONFIG_NLS_CODEPAGE_850=y
#CONFIG_NLS_ISO8859_1=y
#CONFIG_NLS_ISO8859_2=y
#CONFIG_NLS_ISO8859_3=y
#CONFIG_NLS_UTF8=y
#CONFIG_CVITEK_NPU=y
CONFIG_RESET_CONTROLLER=y
CONFIG_RESET_CVITEK=y
CONFIG_DYNAMIC_DEBUG=y
CONFIG_HW_PERF_EVENTS=y

CONFIG_ION_CARVEOUT_HEAP=y
CONFIG_PWM=y
CONFIG_PWM_CVITEK=y
CONFIG_CMD_POWEROFF=y
CONFIG_IKCONFIG=y
CONFIG_IKCONFIG_PROC=y
CONFIG_VIDEO_DEV=y
CONFIG_VIDEO_MEM2MEM_DEINTERLACE=y
CONFIG_VIDEOBUF2_CORE=y
CONFIG_VIDEOBUF2_V4L2=y
CONFIG_VIDEOBUF2_MEMOPS=y
CONFIG_VIDEOBUF2_VMALLOC=y
CONFIG_FORCE_MAX_ZONEORDER=10
CONFIG_STRICT_DEVMEM=n
```

## build/boards/cv183x/cv1835_palladium/u-boot/cvitek_cv1835_palladium_defconfig
```kconfig
CONFIG_ARM=y
CONFIG_TARGET_CVITEK=y
CONFIG_TARGET_CVITEK_CV1835=y
CONFIG_TARGET_CVITEK_CV1835_PALLADIUM=y
CONFIG_SYS_MALLOC_F_LEN=0x2000
CONFIG_IDENT_STRING=" cvitek_cv1835"
CONFIG_DISTRO_DEFAULTS=y
CONFIG_BOOTDELAY=1
# CONFIG_DISPLAY_CPUINFO is not set
# CONFIG_DISPLAY_BOARDINFO is not set
CONFIG_SYS_PROMPT="cv1835# "
# CONFIG_CMD_CONSOLE is not set
# CONFIG_CMD_IMLS is not set
# CONFIG_CMD_XIMG is not set
# CONFIG_CMD_EDITENV is not set
# CONFIG_CMD_ENV_EXISTS is not set
CONFIG_CMD_MEMTEST=y
CONFIG_CMD_UNZIP=y
# CONFIG_CMD_MMC is not set
# CONFIG_CMD_LOADS is not set
# CONFIG_CMD_ARMFLASH is not set
# CONFIG_CMD_FPGA is not set
# CONFIG_CMD_ITEST is not set
CONFIG_CMD_SETEXPR=y
CONFIG_CMD_NFS=y
CONFIG_CMD_CACHE=y
CONFIG_CMD_FAT=y
# CONFIG_CMD_MISC is not set
# CONFIG_ISO_PARTITION is not set
# CONFIG_EFI_PARTITION is not set
CONFIG_BLK=y
CONFIG_DM=y
# CONFIG_DM_MMC is not set
CONFIG_DM_GPIO=y
CONFIG_DWAPB_GPIO=y
CONFIG_CLK=y
# CONFIG_MMC is not set
# CONFIG_MMC_SDHCI is not set
# CONFIG_MMC_SDHCI_SDMA is not set
# CONFIG_MMC_SDHCI_CVITEK is not set
# CONFIG_MTD_NOR_FLASH is not set
CONFIG_OF_LIBFDT=y
CONFIG_OF_CONTROL=y
CONFIG_OF_SEPARATE=y
CONFIG_DEFAULT_DEVICE_TREE="cv1835_palladium"
CONFIG_SYS_NS16550=y
CONFIG_BAUDRATE=19200
CONFIG_ARMV8_SET_SMPEN=y
CONFIG_PHYLIB=y
# CONFIG_PHY_BROADCOM is not set
# CONFIG_PHY_SMSC=y
# CONFIG_PHY_REALTEK=y
# CONFIG_PHY_MARVELL is not set
CONFIG_PHY_FIXED=y
CONFIG_DM_ETH=y
CONFIG_NETDEVICES=y
CONFIG_DWC_ETH_QOS=y
CONFIG_NET_RANDOM_ETHADDR=y
CONFIG_FIT=y
# CONFIG_ARCH_FIXUP_FDT_MEMORY is not set
CONFIG_CMD_CVI_UTASK=y
CONFIG_CMD_CVI_REBOOT=y
CONFIG_CMD_CVI_JPEG=y
# CONFIG_USB is not set
# CONFIG_DM_USB is not set
# CONFIG_USB_STORAGE is not set
# CONFIG_USB_XHCI_HCD is not set
# CONFIG_USB_XHCI_CVITEK is not set
# CONFIG_CMD_USB is not set
CONFIG_DW_TIMER=y
CONFIG_CMD_POWEROFF=y
CONFIG_LZMA=y
```

## build/boards/cv183x/cv1835_wevb_0001a_spinand/cv1835_wevb_0001a_spinand_defconfig
```kconfig
CONFIG_CHIP_cv1835=y
CONFIG_BOARD_wevb_0001a_spinand=y
CONFIG_STORAGE_TYPE_spinand=y
CONFIG_NANDFLASH_BLOCKSIZE=262144
CONFIG_NANDFLASH_PAGESIZE=4096
CONFIG_SENSOR_GCORE_GC2053_1L=y
CONFIG_SENSOR_GCORE_GC2093=y
CONFIG_SENSOR_GCORE_GC4653=y
CONFIG_SENSOR_NEXTCHIP_N5=y
CONFIG_SENSOR_OV_OS08A20=y
CONFIG_SENSOR_OV_OS08A20_SLAVE=y
CONFIG_SENSOR_OV_OS04C10=y
CONFIG_SENSOR_OV_OS04C10_SLAVE=y
CONFIG_SENSOR_SMS_SC200AI=y
CONFIG_SENSOR_SMS_SC4210=y
CONFIG_SENSOR_SMS_SC8238=y
CONFIG_SENSOR_SOI_F23=y
CONFIG_SENSOR_SOI_F35=y
CONFIG_SENSOR_SOI_F35_SLAVE=y
CONFIG_SENSOR_SONY_IMX290_2L=y
CONFIG_SENSOR_SONY_IMX307=y
CONFIG_SENSOR_SONY_IMX307_2L=y
CONFIG_SENSOR_SONY_IMX307_SLAVE=y
CONFIG_SENSOR_SONY_IMX307_SUBLVDS=y
CONFIG_SENSOR_SONY_IMX327=y
CONFIG_SENSOR_SONY_IMX327_2L=y
CONFIG_SENSOR_SONY_IMX327_SLAVE=y
CONFIG_SENSOR_SONY_IMX327_SUBLVDS=y
CONFIG_SENSOR_SONY_IMX334=y
CONFIG_SENSOR_SONY_IMX335=y
```

## build/boards/cv183x/cv1838_wevb_0002a_spinor/cv1838_wevb_0002a_spinor_defconfig
```kconfig
CONFIG_CHIP_cv1838=y
CONFIG_BOARD_wevb_0002a_spinor=y
CONFIG_CROSS_COMPILE_KERNEL="aarch64-linux-gnu-"
CONFIG_TOOLCHAIN_GLIBC_ARM=y
CONFIG_CP_EXT_WIRELESS=y
CONFIG_NO_FB=y
CONFIG_STORAGE_TYPE_spinor=y
CONFIG_SENSOR_OV_OS04C10=y
CONFIG_SENSOR_OV_OS04C10_SLAVE=y
CONFIG_SENSOR_OV_OS08A20=y
CONFIG_SENSOR_OV_OS08A20_SLAVE=y
CONFIG_SENSOR_SONY_IMX327=y
CONFIG_SENSOR_SONY_IMX327_2L=y
CONFIG_SENSOR_SONY_IMX327_SLAVE=y
CONFIG_SENSOR_TUNING_PARAM_cv183x_src_sony_imx307=y
CONFIG_KERNEL_LZMA=y
CONFIG_FLASH_SIZE_SHRINK=y
CONFIG_SKIP_RAMDISK=y
CONFIG_TARGET_PACKAGE_BUSYBOX_SYSLOGD_SCRIPT=y
CONFIG_TARGET_PACKAGE_DROPBEAR=y
```

## build/boards/cv183x/cv1838_wevb_0002a_spinor_0p5t/linux/cvitek_cv1838_wevb_0002a_spinor_0p5t_defconfig
```kconfig
# CONFIG_SWAP is not set
CONFIG_SYSVIPC=y
CONFIG_POSIX_MQUEUE=y
CONFIG_NO_HZ_IDLE=y
CONFIG_HIGH_RES_TIMERS=y
CONFIG_PREEMPT=y
CONFIG_CC_OPTIMIZE_FOR_SIZE=y
# CONFIG_UID16 is not set
# CONFIG_SYSFS_SYSCALL is not set
# CONFIG_FHANDLE is not set
# CONFIG_BASE_FULL is not set
# CONFIG_AIO is not set
# CONFIG_KALLSYMS is not set
CONFIG_EMBEDDED=y
# CONFIG_SLUB_DEBUG is not set
CONFIG_ARCH_CVITEK=y
CONFIG_ARCH_CVITEK_CHIP="cv183x"
CONFIG_FORCE_MAX_ZONEORDER=10
# CONFIG_EFI is not set
CONFIG_COMPAT=y
# CONFIG_SUSPEND is not set
CONFIG_PM=y
# CONFIG_STACKPROTECTOR is not set
CONFIG_MODULES=y
CONFIG_MODULE_FORCE_LOAD=y
CONFIG_MODULE_UNLOAD=y
# CONFIG_BLK_DEV_BSG is not set
# CONFIG_BLK_DEBUG_FS is not set
# CONFIG_IOSCHED_DEADLINE is not set
# CONFIG_IOSCHED_CFQ is not set
# CONFIG_MQ_IOSCHED_DEADLINE is not set
# CONFIG_MQ_IOSCHED_KYBER is not set
# CONFIG_COREDUMP is not set
CONFIG_CMA=y
CONFIG_NET=y
CONFIG_PACKET=y
CONFIG_UNIX=y
CONFIG_INET=y
# CONFIG_INET_XFRM_MODE_TRANSPORT is not set
# CONFIG_INET_XFRM_MODE_TUNNEL is not set
# CONFIG_INET_XFRM_MODE_BEET is not set
# CONFIG_INET_DIAG is not set
# CONFIG_IPV6 is not set
CONFIG_CFG80211=m
CONFIG_MAC80211=m
CONFIG_DEVTMPFS=y
CONFIG_DEVTMPFS_MOUNT=y
# CONFIG_ALLOW_DEV_COREDUMP is not set
CONFIG_MTD=y
CONFIG_MTD_CMDLINE_PARTS=y
# CONFIG_MTD_OF_PARTS is not set
CONFIG_MTD_BLOCK=y
CONFIG_MTD_SPI_NOR=y
CONFIG_SPI_CVI_SPIF=y
CONFIG_NETDEVICES=y
# CONFIG_NET_CORE is not set
# CONFIG_NET_VENDOR_CAVIUM is not set
CONFIG_STMMAC_ETH=y
# CONFIG_DWMAC_GENERIC is not set
CONFIG_CVITEK_PHY=y
CONFIG_CVITEK_PHY_UAPS=y
# CONFIG_USB_NET_DRIVERS is not set
# CONFIG_WLAN_VENDOR_ADMTEK is not set
# CONFIG_WLAN_VENDOR_ATH is not set
# CONFIG_WLAN_VENDOR_ATMEL is not set
# CONFIG_WLAN_VENDOR_BROADCOM is not set
# CONFIG_WLAN_VENDOR_CISCO is not set
# CONFIG_WLAN_VENDOR_INTEL is not set
# CONFIG_WLAN_VENDOR_INTERSIL is not set
# CONFIG_WLAN_VENDOR_MARVELL is not set
CONFIG_MT7603U=m
# CONFIG_WLAN_VENDOR_RALINK is not set
# CONFIG_WLAN_VENDOR_REALTEK is not set
# CONFIG_WLAN_VENDOR_RSI is not set
# CONFIG_WLAN_VENDOR_ST is not set
# CONFIG_WLAN_VENDOR_TI is not set
# CONFIG_WLAN_VENDOR_ZYDAS is not set
# CONFIG_WLAN_VENDOR_QUANTENNA is not set
# CONFIG_INPUT is not set
# CONFIG_SERIO is not set
# CONFIG_VT is not set
# CONFIG_LEGACY_PTYS is not set
CONFIG_SERIAL_8250=y
CONFIG_SERIAL_8250_CONSOLE=y
CONFIG_SERIAL_8250_NR_UARTS=5
CONFIG_SERIAL_8250_RUNTIME_UARTS=5
CONFIG_SERIAL_8250_DW=y
CONFIG_HW_RANDOM=y
CONFIG_I2C=y
CONFIG_I2C_CHARDEV=y
CONFIG_I2C_MUX=y
CONFIG_I2C_DESIGNWARE_PLATFORM=y
CONFIG_SPI=y
# CONFIG_PTP_1588_CLOCK is not set
CONFIG_CVITEK_PINCTRL_CV1835=y
CONFIG_GPIOLIB=y
CONFIG_GPIO_SYSFS=y
CONFIG_GPIO_DWAPB=y
CONFIG_THERMAL=y
CONFIG_THERMAL_WRITABLE_TRIPS=y
CONFIG_THERMAL_EMULATION=y
CONFIG_WATCHDOG=y
CONFIG_DW_WATCHDOG=m
CONFIG_MEDIA_SUPPORT=y
CONFIG_MEDIA_CAMERA_SUPPORT=y
CONFIG_MEDIA_CONTROLLER=y
CONFIG_VIDEO_V4L2_SUBDEV_API=y
CONFIG_V4L_MEM2MEM_DRIVERS=y
CONFIG_VIDEO_MEM2MEM_DEINTERLACE=y
CONFIG_VIDEO_CVITEK=m
CONFIG_VIDEO_CVITEK_CIF=m
CONFIG_VIDEO_CVITEK_SNS_I2C=m
# CONFIG_MEDIA_SUBDRV_AUTOSELECT is not set
CONFIG_SOUND=y
CONFIG_SND=y
# CONFIG_SND_SUPPORT_OLD_API is not set
# CONFIG_SND_PROC_FS is not set
# CONFIG_SND_DRIVERS is not set
# CONFIG_SND_SPI is not set
# CONFIG_SND_USB is not set
CONFIG_SND_SOC=y
CONFIG_SND_SOC_CV1835_CV1835ADC=y
CONFIG_SND_SOC_CV1835_CV1835DAC=y
CONFIG_SND_CV1835_I2S=y
CONFIG_SND_SOC_CV1835ADC=y
CONFIG_SND_SOC_CV1835DAC=y
CONFIG_SND_SOC_CV1835_USE_AUDIO_PLL=y
CONFIG_CV1835_I2S_SUBSYS=y
CONFIG_USB=y
CONFIG_USB_OTG=y
CONFIG_USB_OTG_FSM=y
CONFIG_USB_XHCI_HCD=y
CONFIG_USB_CVITEK_DRD=y
CONFIG_USB_GADGET=y
CONFIG_MMC=y
CONFIG_MMC_SDHCI=y
CONFIG_MMC_SDHCI_PLTFM=y
CONFIG_MMC_SDHCI_CVI=y
CONFIG_RTC_CLASS=y
CONFIG_DMADEVICES=y
CONFIG_DW_DMAC_CVITEK=y
# CONFIG_VIRTIO_MENU is not set
CONFIG_STAGING=y
CONFIG_ION=y
CONFIG_ION_CARVEOUT_HEAP=y
# CONFIG_COMMON_CLK_XGENE is not set
# CONFIG_FSL_ERRATUM_A008585 is not set
# CONFIG_HISILICON_ERRATUM_161010101 is not set
# CONFIG_ARM64_ERRATUM_858921 is not set
# CONFIG_IOMMU_SUPPORT is not set
CONFIG_CV1835_SYSDMA_REMAP=y
CONFIG_PWM=y
CONFIG_ANDROID=y
CONFIG_TEE=y
CONFIG_OPTEE=y
# CONFIG_MANDATORY_FILE_LOCKING is not set
CONFIG_MSDOS_FS=y
CONFIG_VFAT_FS=y
# CONFIG_PROC_PAGE_MONITOR is not set
CONFIG_TMPFS=y
CONFIG_JFFS2_FS=y
CONFIG_JFFS2_COMPRESSION_OPTIONS=y
CONFIG_JFFS2_LZO=y
CONFIG_SQUASHFS=y
# CONFIG_SQUASHFS_ZLIB is not set
CONFIG_SQUASHFS_XZ=y
# CONFIG_NETWORK_FILESYSTEMS is not set
CONFIG_NLS_CODEPAGE_437=y
CONFIG_NLS_CODEPAGE_850=y
CONFIG_NLS_ISO8859_1=y
CONFIG_NLS_ISO8859_2=y
CONFIG_NLS_ISO8859_3=y
CONFIG_NLS_UTF8=y
CONFIG_CRYPTO_CCM=y
CONFIG_CRYPTO_GCM=y
# CONFIG_CRYPTO_ECHAINIV is not set
CONFIG_CRYPTO_CMAC=y
CONFIG_CRYPTO_ARC4=y
# CONFIG_CRYPTO_HW is not set
# CONFIG_XZ_DEC_X86 is not set
# CONFIG_XZ_DEC_POWERPC is not set
# CONFIG_XZ_DEC_IA64 is not set
# CONFIG_XZ_DEC_ARMTHUMB is not set
# CONFIG_XZ_DEC_SPARC is not set
CONFIG_PRINTK_TIME=y
CONFIG_DEBUG_FS=y
# CONFIG_SCHED_DEBUG is not set
# CONFIG_DEBUG_PREEMPT is not set
# CONFIG_DEBUG_BUGVERBOSE is not set
# CONFIG_FTRACE is not set
# CONFIG_RUNTIME_TESTING_MENU is not set
# CONFIG_STRICT_DEVMEM is not set
```
