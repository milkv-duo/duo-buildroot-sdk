## build/boards/cv182x/cv1821_wevb_0005b_spinor/cv1821_wevb_0005b_spinor_defconfig
```kconfig
CONFIG_CUSTOMER="generic"
# CONFIG_CHIP_cv1820 is not set
CONFIG_CHIP_cv1821=y
# CONFIG_CHIP_cv1822 is not set
# CONFIG_CHIP_cv1823 is not set
# CONFIG_CHIP_cv1825 is not set
# CONFIG_CHIP_cv1826 is not set
# CONFIG_CHIP_cv1829 is not set
# CONFIG_CHIP_cv1832 is not set
# CONFIG_CHIP_cv1835 is not set
# CONFIG_CHIP_cv1838 is not set
# CONFIG_CHIP_cv7581 is not set
# CONFIG_CHIP_cv9520 is not set
CONFIG_CHIP="cv1821"
# CONFIG_BOARD_wevb_0005b_spinand is not set
CONFIG_BOARD_wevb_0005b_spinor=y
# CONFIG_BOARD_wevb_0005b_64mb_spinor is not set
CONFIG_BOARD="wevb_0005b_spinor"
CONFIG_ARCH="arm"

#
# Compile-time checks and compiler options
#
CONFIG_CROSS_COMPILE="aarch64-linux-gnu-"
CONFIG_CROSS_COMPILE_KERNEL="arm-linux-gnueabihf-"
# CONFIG_CC_OPTIMIZE_FOR_PERFORMANCE is not set
CONFIG_CC_OPTIMIZE_FOR_SIZE=y
CONFIG_KERNEL_ENTRY_HACK=y
CONFIG_KERNEL_ENTRY_HACK_ADDR="0x80108000"
# CONFIG_DEBUG_INFO is not set
# CONFIG_USE_CCACHE is not set
# end of Compile-time checks and compiler options

#
# SDK options
#
CONFIG_TOOLCHAIN_UCLIBC_ARM=y
# CONFIG_STATIC is not set
# CONFIG_ENABLE_SDK_ASAN is not set
CONFIG_FLASH_SIZE_SHRINK=y
# end of SDK options

#
# FIP setting
#
CONFIG_ATF_KEY_SEL_default=y
# CONFIG_ATF_KEY_SEL_clear is not set
# CONFIG_ATF_KEY_SEL_key1 is not set
CONFIG_ATF_KEY_SEL="default"
# CONFIG_ATF_SRC is not set
# CONFIG_MULTI_FIP is not set
# end of FIP setting

#
# Storage settings
#
# CONFIG_STORAGE_TYPE_none is not set
# CONFIG_STORAGE_TYPE_emmc is not set
# CONFIG_STORAGE_TYPE_spinand is not set
CONFIG_STORAGE_TYPE_spinor=y
# CONFIG_STORAGE_TYPE_sd is not set
CONFIG_STORAGE_TYPE="spinor"
CONFIG_NANDFLASH_BLOCKSIZE=131072
CONFIG_NANDFLASH_PAGESIZE=2048
# end of Storage settings

#
# Sensor settings
#

#
# Sensor support list
#
# CONFIG_SENSOR_GCORE_GC2053 is not set
# CONFIG_SENSOR_GCORE_GC2053_1L is not set
# CONFIG_SENSOR_GCORE_GC2053_SLAVE is not set
# CONFIG_SENSOR_GCORE_GC2093 is not set
# CONFIG_SENSOR_GCORE_GC2093_SLAVE is not set
CONFIG_SENSOR_GCORE_GC4653=y
# CONFIG_SENSOR_GCORE_GC4653_SLAVE is not set
# CONFIG_SENSOR_GCORE_GC1054 is not set
# CONFIG_SENSOR_NEXTCHIP_N5 is not set
# CONFIG_SENSOR_NEXTCHIP_N6 is not set
# CONFIG_SENSOR_OV_OS08A20 is not set
# CONFIG_SENSOR_OV_OS08A20_SLAVE is not set
# CONFIG_SENSOR_PICO_384 is not set
# CONFIG_SENSOR_PICO_640 is not set
# CONFIG_SENSOR_PIXELPLUS_PR2020 is not set
# CONFIG_SENSOR_PIXELPLUS_PR2100 is not set
# CONFIG_SENSOR_SMS_SC035GS is not set
# CONFIG_SENSOR_SMS_SC200AI is not set
CONFIG_SENSOR_SMS_SC3335=y
# CONFIG_SENSOR_SMS_SC3335_SLAVE is not set
# CONFIG_SENSOR_SMS_SC4210 is not set
CONFIG_SENSOR_SMS_SC500AI=y
# CONFIG_SENSOR_SMS_SC501AI_2L is not set
# CONFIG_SENSOR_SMS_SC8238 is not set
# CONFIG_SENSOR_SOI_F23 is not set
# CONFIG_SENSOR_SOI_F35 is not set
# CONFIG_SENSOR_SOI_F35_SLAVE is not set
# CONFIG_SENSOR_SOI_H65 is not set
# CONFIG_SENSOR_SONY_IMX290_2L is not set
CONFIG_SENSOR_SONY_IMX307=y
CONFIG_SENSOR_SONY_IMX307_2L=y
CONFIG_SENSOR_SONY_IMX307_SLAVE=y
# CONFIG_SENSOR_SONY_IMX307_SUBLVDS is not set
CONFIG_SENSOR_SONY_IMX327=y
CONFIG_SENSOR_SONY_IMX327_2L=y
CONFIG_SENSOR_SONY_IMX327_SLAVE=y
# CONFIG_SENSOR_SONY_IMX327_SUBLVDS is not set
# CONFIG_SENSOR_SONY_IMX334 is not set
# CONFIG_SENSOR_SONY_IMX335 is not set
# CONFIG_SENSOR_SONY_IMX327_FPGA is not set
# CONFIG_SENSOR_SONY_IMX347 is not set
# CONFIG_SENSOR_SONY_IMX385 is not set
# CONFIG_SENSOR_VIVO_MCS369 is not set
# CONFIG_SENSOR_VIVO_MCS369Q is not set
# CONFIG_SENSOR_VIVO_MCS308M2 is not set
# end of Sensor support list

#
# Sensor tuning param config
#

#
# src
#
CONFIG_SENSOR_TUNING_PARAM_cv182x_src_sony_imx307=y
# CONFIG_SENSOR_TUNING_PARAM_cv182x_src_sony_imx307_sony_imx307 is not set
# CONFIG_SENSOR_TUNING_PARAM_cv182x_src_sms_sc500ai is not set
# CONFIG_SENSOR_TUNING_PARAM_cv182x_src_sony_imx327 is not set
# CONFIG_SENSOR_TUNING_PARAM_cv182x_src_gcore_gc2093_gcore_gc2053 is not set
# end of src

CONFIG_SENSOR_TUNING_PARAM="sony_imx307"
# end of Sensor tuning param config
# end of Sensor settings

#
# panel settings
#

#
# panel support list
#
CONFIG_MIPI_PANEL_HX8394=y
# CONFIG_MIPI_PANEL_ILI9881C is not set
# CONFIG_MIPI_PANEL_ILI9881D is not set
# CONFIG_MIPI_PANEL_JD9366AB is not set
# CONFIG_MIPI_PANEL_NT35521 is not set
# CONFIG_MIPI_PANEL_OTA7290B is not set
# CONFIG_MIPI_PANEL_OTA7290B_1920 is not set
# CONFIG_MIPI_PANEL_ICN9707 is not set
# CONFIG_MIPI_PANEL_3AML069LP01G is not set
# CONFIG_MIPI_PANEL_ST7701 is not set
# CONFIG_I80_PANEL_ST7789V is not set
# end of panel support list

#
# MIPI panel tuning param config
#
# CONFIG_MIPI_PANEL_4_LANES is not set
CONFIG_MIPI_PANEL_2_LANES=y
CONFIG_MIPI_PANEL_LANE_SWAP=y
CONFIG_PANEL_TUNING_PARAM="MIPI_panel_hx8394"
CONFIG_PANEL_LANE_NUM_TUNING_PARAM="MIPI_panel_2_lanes"
CONFIG_PANEL_LANE_SWAP_TUNING_PARAM="MIPI_panel_lane_swap"
# end of MIPI panel tuning param config
# end of panel settings

#
# Kernel options
#
CONFIG_KERNEL_SRC_4_19=y
# CONFIG_KERNEL_SRC_4_9 is not set
CONFIG_KERNEL_SRC="linux"
# CONFIG_KERNEL_GZIP is not set
CONFIG_KERNEL_LZMA=y
# CONFIG_KERNEL_LZ4 is not set
# CONFIG_KERNEL_UNCOMPRESSED is not set
CONFIG_KERNEL_COMPRESS="lzma"
# end of Kernel options

#
# ROOTFS options
#
CONFIG_SKIP_RAMDISK=y
# CONFIG_ROOTFS_OVERLAYFS is not set
# end of ROOTFS options

#
# Turnkey options
#
# CONFIG_BUILD_TURNKEY_ACCESSGUARD is not set
# CONFIG_BUILD_TURNKEY_IPC is not set
# end of Turnkey options

#
# RTOS options
#
# CONFIG_ENABLE_FREERTOS is not set
# end of RTOS options

#
# Rootfs packages
#
CONFIG_TARGET_PACKAGE_DROPBEAR=y
CONFIG_TARGET_PACKAGE_BUSYBOX_SYSLOGD_SCRIPT=y
# end of Rootfs packages
```

## build/boards/cv182x/cv1822_wevb_0005b_64mb_spinand/u-boot/cvitek_cv1822_wevb_0005b_64mb_spinand_defconfig
```kconfig
CONFIG_ARM=y
CONFIG_TARGET_CVITEK=y
CONFIG_TARGET_CVITEK_CV1822=y
CONFIG_TARGET_CVITEK_CV1822_ASIC=y
CONFIG_SYS_MALLOC_F_LEN=0x2000
CONFIG_IDENT_STRING=" cvitek_cv1822"
CONFIG_DISTRO_DEFAULTS=y
CONFIG_BOOTDELAY=1
# CONFIG_DISPLAY_CPUINFO is not set
# CONFIG_DISPLAY_BOARDINFO is not set
CONFIG_SYS_PROMPT="cv1822# "
# CONFIG_CMD_CONSOLE is not set
# CONFIG_CMD_IMLS is not set
# CONFIG_CMD_XIMG is not set
# CONFIG_CMD_EDITENV is not set
# CONFIG_CMD_ENV_EXISTS is not set
CONFIG_CMD_MEMTEST=y
CONFIG_CMD_UNZIP=y
CONFIG_CMD_MMC=y
# CONFIG_CMD_LOADS is not set
# CONFIG_CMD_ARMFLASH is not set
# CONFIG_CMD_FPGA is not set
# CONFIG_CMD_ITEST is not set
CONFIG_CMD_SETEXPR=y
CONFIG_CMD_NFS=y
CONFIG_CMD_CACHE=y
CONFIG_CMD_FAT=y
# CONFIG_CMD_MISC is not set
# CONFIG_ISO_PARTITION is not set
CONFIG_EFI_PARTITION=y
CONFIG_BLK=y
CONFIG_DM=y
CONFIG_DM_MMC=y
CONFIG_DM_GPIO=y
CONFIG_DWAPB_GPIO=y
CONFIG_CLK=y
CONFIG_MMC=y
CONFIG_MMC_SDHCI=y
CONFIG_MMC_SDHCI_SDMA=y
CONFIG_MMC_SDHCI_CVITEK=y
# CONFIG_MMC_SDHCI_CVITEK_WIFI is not set
# CONFIG_MTD_NOR_FLASH is not set
CONFIG_OF_LIBFDT=y
CONFIG_OF_CONTROL=y
CONFIG_OF_SEPARATE=y
CONFIG_DEFAULT_DEVICE_TREE="cv1822_asic"
CONFIG_SYS_NS16550=y
CONFIG_BAUDRATE=115200
CONFIG_ARMV8_SET_SMPEN=y
CONFIG_PHYLIB=y
# CONFIG_PHY_BROADCOM is not set
#CONFIG_PHY_SMSC=y
# CONFIG_PHY_FIXED is not set
CONFIG_PHY_CVITEK=y
CONFIG_DM_ETH=y
CONFIG_NETDEVICES=y
CONFIG_ETH_DESIGNWARE=y
CONFIG_NET_RANDOM_ETHADDR=y
CONFIG_FIT=y
# CONFIG_ARCH_FIXUP_FDT_MEMORY is not set
CONFIG_CMD_CVI_UTASK=y
# CONFIG_CMD_CVI_JPEG is not set
CONFIG_CMD_CVI_REBOOT=y
CONFIG_CMD_CVI_SD_UPDATE=y
#CONFIG_CMD_CVI_VO=y
# CONFIG_USB is not set
# CONFIG_DM_USB is not set
# CONFIG_USB_STORAGE is not set
# CONFIG_USB_XHCI_HCD is not set
# CONFIG_USB_XHCI_CVITEK is not set
# CONFIG_CMD_USB is not set
CONFIG_RSA=y
CONFIG_RSA_SOFTWARE_EXP=y
CONFIG_CMD_AES=y
CONFIG_FIT_SIGNATURE=y
CONFIG_FIT_VERBOSE=y
#CONFIG_PARTITIONS=y
#CONFIG_CMD_ELF=n
#CONFIG_CMD_BOOTEFI=n
#CONFIG_EFI_LOADER=n
CONFIG_CMD_GPT=n
CONFIG_CMD_PART=y
#CONFIG_DISPLAY=y
#CONFIG_DM_VIDEO=y
#CONFIG_VIDEO_CVITEK=y
#CONFIG_DISPLAY_CVITEK_MIPI=y
#CONFIG_DISPLAY_CVITEK_LVDS=y
CONFIG_DW_TIMER=y
#CONFIG_BOOTLOGO=n
CONFIG_CMD_POWEROFF=y
CONFIG_LZMA=y
CONFIG_SYS_BOOTMAPSZ=0x4000000
# CONFIG_CMD_CVI_SAPD is not set
```

## build/boards/cv182x/cv1825_wevb_0005a_spinor/cv1825_wevb_0005a_spinor_defconfig
```kconfig
CONFIG_CHIP_cv1825=y
CONFIG_BOARD_wevb_0005a_spinor=y
CONFIG_ARCH="arm"
CONFIG_CROSS_COMPILE_KERNEL="arm-linux-gnueabihf-"
CONFIG_CC_OPTIMIZE_FOR_SIZE=y
CONFIG_KERNEL_ENTRY_HACK=y
CONFIG_KERNEL_ENTRY_HACK_ADDR="0x80108000"
CONFIG_TOOLCHAIN_UCLIBC_ARM=y
CONFIG_FLASH_SIZE_SHRINK=y
CONFIG_STORAGE_TYPE_spinor=y
CONFIG_SENSOR_GCORE_GC4653=y
CONFIG_SENSOR_SMS_SC3335=y
CONFIG_SENSOR_SMS_SC500AI=y
CONFIG_SENSOR_SONY_IMX307=y
CONFIG_SENSOR_SONY_IMX307_2L=y
CONFIG_SENSOR_SONY_IMX307_SLAVE=y
CONFIG_SENSOR_SONY_IMX327=y
CONFIG_SENSOR_SONY_IMX327_2L=y
CONFIG_SENSOR_SONY_IMX327_SLAVE=y
CONFIG_SENSOR_TUNING_PARAM_cv182x_src_sony_imx307=y
CONFIG_MIPI_PANEL_2_LANES=y
CONFIG_MIPI_PANEL_LANE_SWAP=y
CONFIG_KERNEL_LZMA=y
CONFIG_SKIP_RAMDISK=y
# CONFIG_ROOTFS_OVERLAYFS is not set
CONFIG_TARGET_PACKAGE_DROPBEAR=y
# CONFIG_TARGET_PACKAGE_GDBSERVER is not set
# CONFIG_TARGET_PACKAGE_LIBCRYPTO is not set
CONFIG_TARGET_PACKAGE_MTD-UTILS=y
# CONFIG_TARGET_PACKAGE_OTASERVER is not set
# CONFIG_TARGET_PACKAGE_RSYSLOG is not set
```

## build/boards/cv182x/cv1826_wevb_0005a_spinand/cv1826_wevb_0005a_spinand_defconfig
```kconfig
CONFIG_CUSTOMER="generic"
# CONFIG_CHIP_cv1832 is not set
CONFIG_CHIP_cv1826=y
# CONFIG_CHIP_cv1835 is not set
# CONFIG_CHIP_cv1821 is not set
# CONFIG_CHIP_cv1838 is not set
# CONFIG_CHIP_cv1829 is not set
# CONFIG_CHIP_cv9520 is not set
# CONFIG_CHIP_cv7581 is not set
# CONFIG_CHIP_cv1822 is not set
CONFIG_CHIP="cv1826"
# CONFIG_BOARD_wevb_0005a_aarch32_spinand is not set
CONFIG_BOARD_wevb_0005a_spinand=y
CONFIG_BOARD="wevb_0005a_spinand"
CONFIG_ARCH="arm"

#
# Compile-time checks and compiler options
#
CONFIG_CROSS_COMPILE="aarch64-linux-gnu-"
CONFIG_CROSS_COMPILE_KERNEL="arm-linux-gnueabihf-"
CONFIG_CC_OPTIMIZE_FOR_PERFORMANCE=y
# CONFIG_CC_OPTIMIZE_FOR_SIZE is not set
CONFIG_KERNEL_ENTRY_HACK=y
CONFIG_KERNEL_ENTRY_HACK_ADDR="0x80108000"
# CONFIG_DEBUG_INFO is not set
# CONFIG_USE_CCACHE is not set
# end of Compile-time checks and compiler options

#
# SDK options
#
# CONFIG_TOOLCHAIN_GLIBC_ARM64 is not set
CONFIG_TOOLCHAIN_GLIBC_ARM=y
# CONFIG_TOOLCHAIN_UCLIBC_ARM is not set
CONFIG_CROSS_COMPILE_SDK="arm-linux-gnueabihf-"
CONFIG_SDK_VER="32bit"
# CONFIG_STATIC is not set
# CONFIG_ENABLE_SDK_ASAN is not set
# end of SDK options

#
# FIP setting
#
CONFIG_ATF_KEY_SEL_default=y
# CONFIG_ATF_KEY_SEL_clear is not set
# CONFIG_ATF_KEY_SEL_key1 is not set
CONFIG_ATF_KEY_SEL="default"
# CONFIG_ATF_SRC is not set
# CONFIG_MULTI_FIP is not set
# end of FIP setting

#
# Storage settings
#
CONFIG_STORAGE_TYPE_spinand=y
CONFIG_NANDFLASH_BLOCKSIZE=131072
CONFIG_NANDFLASH_PAGESIZE=2048
# end of Storage settings

#
# Sensor settings
#
CONFIG_SENSOR_SMS_SC035GS=y
CONFIG_SENSOR_GCORE_GC2053_1L=y
# CONFIG_SENSOR_GCORE_GC2053 is not set
# CONFIG_SENSOR_GCORE_GC2053_SLAVE is not set
CONFIG_SENSOR_GCORE_GC2093=y
# CONFIG_SENSOR_GCORE_GC2093_SLAVE is not set
CONFIG_SENSOR_GCORE_GC4653=y
CONFIG_SENSOR_GCORE_GC1054=y
CONFIG_SENSOR_NEXTCHIP_N5=y
CONFIG_SENSOR_NEXTCHIP_N6=y
CONFIG_SENSOR_OV_OS08A20=y
# CONFIG_SENSOR_OV_OS08A20_SLAVE is not set
# CONFIG_SENSOR_PICO_384 is not set
# CONFIG_SENSOR_PICO_640 is not set
CONFIG_SENSOR_PIXELPLUS_PR2020=y
# CONFIG_SENSOR_PIXELPLUS_PR2100 is not set
CONFIG_SENSOR_SMS_SC200AI=y
CONFIG_SENSOR_SMS_SC500AI=y
# CONFIG_SENSOR_SMS_SC3335 is not set
# CONFIG_SENSOR_SMS_SC3335_SLAVE is not set
# CONFIG_SENSOR_SMS_SC4210 is not set
# CONFIG_SENSOR_SMS_SC8238 is not set
CONFIG_SENSOR_SOI_F23=y
CONFIG_SENSOR_SOI_F35=y
# CONFIG_SENSOR_SOI_F35_SLAVE is not set
# CONFIG_SENSOR_SOI_H65 is not set
# CONFIG_SENSOR_SONY_IMX290_2L is not set
CONFIG_SENSOR_SONY_IMX307=y
CONFIG_SENSOR_SONY_IMX307_2L=y
CONFIG_SENSOR_SONY_IMX307_SLAVE=y
# CONFIG_SENSOR_SONY_IMX307_SUBLVDS is not set
CONFIG_SENSOR_SONY_IMX327=y
CONFIG_SENSOR_SONY_IMX327_2L=y
CONFIG_SENSOR_SONY_IMX327_SLAVE=y
# CONFIG_CONFIG_SENSOR_SONY_IMX327_SUBLVDS is not set
# CONFIG_SENSOR_SONY_IMX334 is not set
CONFIG_SENSOR_SONY_IMX335=y
# CONFIG_SENSOR_SONY_IMX347 is not set
# CONFIG_SENSOR_SONY_IMX385 is not set
# CONFIG_SENSOR_VIVO_MCS369 is not set
# CONFIG_SENSOR_VIVO_MCS369Q is not set
# CONFIG_SENSOR_VIVO_MCS308m2 is not set
# end of Sensor settings

#
# MIPI panel settings
#

#
# MIPI panel support list
#
CONFIG_MIPI_PANEL_HX8394=y
# CONFIG_MIPI_PANEL_ILI9881C is not set
# CONFIG_MIPI_PANEL_ILI9881D is not set
# CONFIG_MIPI_PANEL_JD9366AB is not set
# CONFIG_MIPI_PANEL_NT35521 is not set
# CONFIG_MIPI_PANEL_OTA7290B is not set
# CONFIG_MIPI_PANEL_OTA7290B_1920 is not set
# CONFIG_MIPI_PANEL_ICN9707 is not set
# end of MIPI panel support list

#
# MIPI panel tuning param config
#
CONFIG_MIPI_PANEL_4_LANES=y
# CONFIG_MIPI_PANEL_2_LANES is not set
CONFIG_MIPI_PANEL_LANE_SWAP=y
# end of MIPI panel tuning param config
# end of MIPI panel settings

#
# Kernel options
#
# CONFIG_KERNEL_SRC_4_9 is not set
CONFIG_KERNEL_SRC_4_19=y
CONFIG_KERNEL_SRC="linux"
# end of Kernel options

#
# ROOTFS options
#
CONFIG_ROOTFS_OVERLAYFS=y
# end of ROOTFS options

#
# RTOS options
#
# CONFIG_ENABLE_FREERTOS is not set
# end of RTOS options

CONFIG_SENSOR_TUNING_PARAM_cv182x_src_sony_imx307_sony_imx307=y

#
# Rootfs packages
#
# end of Rootfs packages
```
