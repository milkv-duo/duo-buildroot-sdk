/dts-v1/;
#include "cv180x_base_riscv.dtsi"
#include "cv180x_asic_qfn.dtsi"
#include "cv180x_asic_spinor.dtsi"
#include "cv180x_default_memmap.dtsi"

&mipi_rx{
	snsr-reset = <&portc 8 GPIO_ACTIVE_LOW>, <&portc 8 GPIO_ACTIVE_LOW>, <&portc 8 GPIO_ACTIVE_LOW>;
};

/ {
	wifi_pin {
		compatible = "cvitek,wifi-pin";
		poweron-gpio = <&porte 25 GPIO_ACTIVE_HIGH>;
		wakeup-gpio = <&porte 26 GPIO_ACTIVE_HIGH>;

	};
};

