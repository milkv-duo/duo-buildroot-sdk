
&GIC_BASE=0x01F00000
&PLAT_ARM_GICD_BASE=&GIC_BASE+0x1000
&PLAT_ARM_GICC_BASE=&GIC_BASE+0x2000
print "PLAT_ARM_GICD_BASE=&PLAT_ARM_GICD_BASE"
print "PLAT_ARM_GICC_BASE=&PLAT_ARM_GICC_BASE"

&GICD_CTLR=0x0
&GICD_IGROUPR=0x80
&GICD_ISENABLER=0x100
&GICD_ICENABLER=0x180
&GICD_IPRIORITYR=0x400

; Disable the distributor before going further
Data.Set PM:&PLAT_ARM_GICD_BASE+&GICD_CTLR %LONG 0

; Configure secure G0 SGIs and PPIs.
Data.Set PM:&PLAT_ARM_GICD_BASE+&GICD_ICENABLER %LONG 0x2000ffff

Data.Set PM:(&PLAT_ARM_GICD_BASE+&GICD_IPRIORITYR)++0x4ff %LONG 0x80808080
Data.Set PM:(&PLAT_ARM_GICD_BASE+&GICD_IPRIORITYR+0x08)++0x0f %LONG 0
Data.Set PM:(&PLAT_ARM_GICD_BASE+&GICD_IPRIORITYR+0x18) %LONG 0x80808000
Data.Set PM:(&PLAT_ARM_GICD_BASE+&GICD_IPRIORITYR+0x1c) %LONG 0x80800080

Data.Set PM:(&PLAT_ARM_GICD_BASE+&GICD_IGROUPR)++0x1f %LONG 0xffffffff
Data.Set PM:&PLAT_ARM_GICD_BASE+&GICD_IGROUPR %LONG 0xde00ffff

Data.Set PM:&PLAT_ARM_GICD_BASE+&GICD_ISENABLER %LONG 0x2000ffff

; Re-enable the secure SPIs now that they have been configured
Data.Set PM:&PLAT_ARM_GICD_BASE+&GICD_CTLR %LONG 1
print "GICD_CTLR=" Data.Long(PM:&PLAT_ARM_GICD_BASE+&GICD_CTLR)

; Enable the Group 0 interrupts, FIQEn and disable Group 0/1 bypass.
&GIC_PRI_MASK=0xff
&FIQ_EN_SHIFT=3
&FIQ_EN_BIT=1<<&FIQ_EN_SHIFT
&FIQ_BYP_DIS_GRP0=1<<5
&IRQ_BYP_DIS_GRP0=1<<6
&FIQ_BYP_DIS_GRP1=1<<7
&IRQ_BYP_DIS_GRP1=1<<8

&GICC_CTLR=0x0
&GICC_PMR=0x4
&CTLR_ENABLE_G0_BIT=0x1
&val=&CTLR_ENABLE_G0_BIT|&FIQ_EN_BIT|&FIQ_BYP_DIS_GRP0|&IRQ_BYP_DIS_GRP0|&FIQ_BYP_DIS_GRP1|&IRQ_BYP_DIS_GRP1

Data.Set PM:&PLAT_ARM_GICC_BASE+&GICC_PMR %LONG &GIC_PRI_MASK
Data.Set PM:&PLAT_ARM_GICC_BASE+&GICC_CTLR %LONG &val
print "GICC_PMR=" Data.Long(PM:&PLAT_ARM_GICC_BASE+&GICC_PMR)
print "GICC_CTLR=" Data.Long(PM:&PLAT_ARM_GICC_BASE+&GICC_CTLR)

print "GIC setting done"
print
