;winclear
system.reset
translation.reset
symbol.reset
map.reset

system.cpu cortexa53
system.config debugaccessport 0
system.config apbaccessport 0
system.config axiaccessport 1
system.config memoryaccessport 1
sys.config corenumber 2
sys.config corebase 0x81010000 0x81110000
sys.config ctibase  0x81020000 0x81120000
sys.jc    20mhz

; Wait 10.ms
system.option enreset on
system.option trst    on
system.option resetbreak on
system.option waitreset  500.ms
OPTION.SerialWire ON
 
winpos 20% 0% 20% 100%
AREA
AREA.Clear

sys.down
sys.up

if system.up()
(
	data.list
)
else
(
	dialog.ok "system.up failed"
)

winpos 50% 0% 50% 100%
register

; Reset
break;
WAIT !ISRUN() ;wait until target stop
;DO cv1835_core_reset.cmm

; Load firmware
LoadBINARY fip.bin PM:0x0c040000 ; TPU SRAM
LoadBINARY ramboot_mini.itb PM:0x100090000

;/mnt/workspace/bm188x/arm-trusted-firmware -> X:\bm188x\arm-trusted-firmware
;data.load.elf Y:\bm1882\install\soc_bm1882_fpga\bl1.elf /StripPART 6 /PATH Y:\bm1882\arm-trusted-firmware
;data.load.elf C:\Workspace\Documents\bm1882\install\bl1.elf /StripPART 6 /PATH Y:\bm1882\arm-trusted-firmware
;data.load.elf C:\Workspace\Documents\bm1882\soc_bm1882_fpga\bl1.elf /StripPART 6 /PATH Y:\bm1882\arm-trusted-firmware
;data.load.elf Y:\bm1882\install\soc_bm1882_fpga\bl1.elf /nocode /StripPART 6 /PATH Y:\bm1882\arm-trusted-firmware
;data.load.elf X:\bm188x\install\soc_bm1882_fpga\bl2.elf /nocode /StripPART 5 /PATH X:\bm188x\arm-trusted-firmware
;data.load.elf X:\bm188x\install\soc_bm1882_fpga\bl31.elf /nocode /StripPART 5 /PATH X:\bm188x\arm-trusted-firmware
;data.load.elf X:\bm188x\install\soc_bm1882_fpga\u-boot /nocode  /StripPART 5 /PATH X:\bm188x\u-boot
;data.load.elf X:\bm188x\install\soc_bm1882_fpga\u-boot 0x07f6f000 /nocode  /StripPART 5 /PATH X:\bm188x\u-boto
;data.load.elf X:\bm188x\install\soc_bm1882_fpga\vmlinux /nocode  /StripPART 5 /PATH X:\bm188x\linux-linaro-stable
; vmlinux 0x100080000

; DebugList
;LoadLastWindow

; Select core: [0, 1]
debuglist /core 0
