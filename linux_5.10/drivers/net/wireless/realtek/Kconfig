## osdrv/extdrv/wireless/mediatek/mt7603/Kconfig
```kconfig
config RLT_WIFI
	tristate "RLT WIFI Driver"
	select WIFI_BASIC_FUNC if RLT_WIFI

config MT_WIFI_PATH
        string
        depends on RLT_WIFI
        default "rlt_wifi"

if RLT_WIFI
menu "WiFi Generic Feature Options"
choice
        prompt "EEPROM Type of 1st Card"
        depends on ! FIRST_IF_NONE

        config FIRST_IF_EEPROM_PROM
        bool "EEPROM"

        config FIRST_IF_EEPROM_EFUSE
        bool "EFUSE"

        config FIRST_IF_EEPROM_FLASH
        bool "FLASH"
endchoice

config RT_FIRST_CARD_EEPROM
        string
        depends on ! FIRST_IF_NONE
        default "prom" if FIRST_IF_EEPROM_PROM
        default "efuse" if FIRST_IF_EEPROM_EFUSE
        default "flash" if FIRST_IF_EEPROM_FLASH

choice
        prompt "EEPROM Type of 2nd Card"
        depends on ! SECOND_IF_NONE

        config SECOND_IF_EEPROM_PROM
        bool "EEPROM"

        config SECOND_IF_EEPROM_EFUSE
        bool "EFUSE"

        config SECOND_IF_EEPROM_FLASH
        bool "FLASH"
endchoice

config RT_SECOND_CARD_EEPROM
        string
        depends on ! SECOND_IF_NONE
        default "prom" if SECOND_IF_EEPROM_PROM
        default "efuse" if SECOND_IF_EEPROM_EFUSE
        default "flash" if SECOND_IF_EEPROM_FLASH

config MULTI_INF_SUPPORT
        bool
        default y if !FIRST_IF_NONE && !SECOND_IF_NONE

config WIFI_BASIC_FUNC
	bool "Basic Functions"
	select WIRELESS_EXT
	select WEXT_SPY
	select WEXT_PRIV
        
config WSC_INCLUDED
	bool "WSC (WiFi Simple Config)"
	depends on WIFI_DRIVER
    default y

config WSC_V2_SUPPORT
	bool "WSC V2(WiFi Simple Config Version 2.0)"
	depends on WIFI_DRIVER
    default y

config WSC_NFC_SUPPORT
	bool "WSC out-of-band(NFC)"
        depends on WIFI_DRIVER
    	default n

config DOT11N_DRAFT3
	bool "802.11n Draft3"
	depends on WIFI_DRIVER
    default n
    
config DOT11_VHT_AC
	bool "802.11 ac"
	depends on WIFI_DRIVER
    default n
    
config DOT11W_PMF_SUPPORT
	bool "PMF"
	depends on WIFI_DRIVER
    default n

config TXBF_SUPPORT
    bool "Tx Bean Forming Support"
    depends on WIFI_DRIVER
    default n

#config WMM_ACM_SUPPORT
#	bool "WMM ACM"
#	depends on WIFI_DRIVER
#   default n
	
config LLTD_SUPPORT
	bool "LLTD (Link Layer Topology Discovery Protocol)"
	depends on WIFI_DRIVER
    default n

config QOS_DLS_SUPPORT
	bool "802.11e DLS ((Direct-Link Setup) Support"
	depends on WIFI_DRIVER
    default n

config WAPI_SUPPORT
	bool "WAPI Support"
	depends on WIFI_DRIVER
    default n

config CARRIER_DETECTION_SUPPORT
	bool "Carrier Detect"
	depends on WIFI_DRIVER
    default n

config IGMP_SNOOP_SUPPORT
	bool "IGMP Snooping"
	depends on WIFI_DRIVER
    default n

config BLOCK_NET_IF
	bool "NETIF Block"
	depends on WIFI_DRIVER
    default n
	help
	Support Net interface block while Tx-Sw queue full

config TXBF_SUPPORT
    bool "Tx Bean Forming Support (Only 3883)"
    depends on WIFI_DRIVER
    depends on RALINK_RT2883 || RALINK_RT3883
    default n

#config VIDEO_TURBINE_SUPPORT
#	bool "Video Turbine support"
#	depends on WIFI_DRIVER
#   default n

#config RA_CLASSIFIER
#	tristate "Ralink Flow Classifier"
#	depends on WIFI_DRIVER
#	default n

config RATE_ADAPTION
    bool "New Rate Adaptation support"
    depends on WIFI_DRIVER
    default n

config NEW_RATE_ADAPT_SUPPORT
    bool "Intelligent Rate Adaption"
    depends on WIFI_DRIVER && RATE_ADAPTION
    default y

config AGS_SUPPORT
	bool "Adaptive Group Switching"
	depends on WIFI_DRIVER && RATE_ADAPTION
    default n
    
config IDS_SUPPORT
	bool "IDS (Intrusion Detection System) Support"
	depends on WIFI_DRIVER
    default n

config WIFI_WORK_QUEUE
	bool "Work Queue"
	depends on WIFI_DRIVER
    default n

config WIFI_SKB_RECYCLE
    bool "SKB Recycle(Linux)"
    depends on WIFI_DRIVER
    default n

config RTMP_FLASH_SUPPORT
	bool "Flash Support"
	depends on WIFI_DRIVER
    default n

config BTCOEX_CONCURRENT
    bool "Coexisence Event Notify between BT and WiFi"
    depends on WIFI_DRIVER
    default n

config LED_CONTROL_SUPPORT
	bool "LED Support"
	depends on WIFI_DRIVER
    default n

config SINGLE_SKU_V2
    bool "Single SKU V2"
    depends on WIFI_DRIVER
    default n

config HW_ANTENNA_DIVERSITY
	bool "Antenna Diversity Support"
	depends on RLT_AP_SUPPORT || RLT_STA_SUPPORT
	depends on RALINK_RT5350
    default n

config ATE_SUPPORT
	bool "ATE/QA Support"
	depends on WIFI_DRIVER
    default n

config RT2860V2_AP_V24_DATA_STRUCTURE
	bool
	depends on WIFI_DRIVER
	default y

config  RT2860V2_AP_32B_DESC
	bool "32 Byte Descriptor Support"
	depends on WIFI_DRIVER
	depends on RALINK_RT6352 || RALINK_MT7620
	default n

config MEMORY_OPTIMIZATION
	bool "Memory Optimization"
	depends on WIFI_DRIVER
    default n

config RTMP_INTERNAL_TX_ALC
    bool "TSSI Compensation"
    depends on WIFI_DRIVER
    depends on RALINK_RT3350 || RALINK_RT3352 || RALINK_RT5350 || RALINK_RT6352
	default n
    
config RTMP_TEMPERATURE_CALIBRATION
    bool "Temperature Calibration"
    depends on WIFI_DRIVER
    depends on RALINK_RT6352
    default n

config HOTSPOT
	bool "Passpoint-R1"
	depends on WIFI_DRIVER
    default n

config HOTSPOT_R2
	bool "Passpoint Release-2 Support"
	depends on HOTSPOT
	select DOT11W_PMF_SUPPORT
	default n

config UAPSD
	bool "UAPSD support"
	depends on WIFI_DRIVER
	default y

#
# Section for chip architectures
#
# "RLT MAC Support"
config RLT_MAC
	bool
	depends on WIFI_DRIVER
	default n

config RLT_BBP
	bool

config RLT_RF
	bool

# "RTMP MAC Support"
config RTMP_MAC
	bool
	depends on WIFI_DRIVER
	default n

config RTMP_BBP
    	bool

config RTMP_RF
    	bool

#
# Section for interfaces
#
config RTMP_PCI_SUPPORT
    	bool

config RTMP_USB_SUPPORT
	bool

config RTMP_RBUS_SUPPORT
    	bool

endmenu

menu "WiFi Operation Modes"
    choice
        prompt "Main Mode"
        default WIFI_MODE_AP

        config WIFI_MODE_AP
                bool "AP"

        config WIFI_MODE_STA
                bool "STA"

        config WIFI_MODE_BOTH
                bool "APSTA"
    endchoice

    if WIFI_MODE_AP || WIFI_MODE_BOTH
        source "drivers/net/wireless/rlt_wifi_ap/Kconfig"
    endif

    #if WIFI_MODE_STA || WIFI_MODE_BOTH
     #   source "drivers/net/wireless/rlt_wifi_sta/Kconfig"
    #endif
endmenu	

#"RT2860 series"
config RALINK_RT28XX
        bool
        default n
        select RTMP_PCI_SUPPORT

#"RT3092"
config RALINK_RT3092
        bool
        default n
        select RTMP_PCI_SUPPORT

#"RT3572"
config RALINK_RT3572
        bool
        default n
        select RTMP_USB_SUPPORT

#"RT5392"
config RALINK_RT5392
        bool
        default n
        select RTMP_PCI_SUPPORT

#"RT5572"
config RALINK_RT5572
        bool
        default n
        select RTMP_USB_SUPPORT

#"RT5592"
config RALINK_RT5592
        bool
        default n
        select RTMP_PCI_SUPPORT

#"MT7620/RT6352"
config RALINK_RT6352
        bool
        default n
        select RTMP_RBUS_SUPPORT
#        select RTMP_TEMPERATURE_CALIBRATION
#        select RTMP_INTERNAL_TX_ALC

#"MT7610E"
config RALINK_MT7610E
        bool
        default n
        select RTMP_PCI_SUPPORT

#"MT7610U"
config RALINK_MT7610U
        bool
        default n
        select RTMP_USB_SUPPORT

#"RT8592"
config RALINK_RT8592
        bool
        default n
        select RTMP_PCI_SUPPORT

#"MT7612E"
config RALINK_MT7612E
        bool
        default n
        select RTMP_PCI_SUPPORT

#"MT7612U"
config RALINK_MT7612U
        bool
        default n
        select RTMP_USB_SUPPORT

#"MT7603E"
config RALINK_MT7603E
        bool
        default n
        select RTMP_PCI_SUPPORT

#"MT7603U"
config RALINK_MT7603U
        bool
        default n
        select RTMP_USB_SUPPORT

endif

#if RLT_MAC
#	config RLT_MAC
#		bool
#		default y
#endif

#if RTMP_MAC
#	config RTMP_MAC
#		bool
#		default y
#endif

if RALINK_MT7603E
	config MT_MAC
		bool
		default y
endif

if RALINK_MT7603U
	config MT_MAC
		bool
		default y
endif
```

## osdrv/extdrv/wireless/realtek/Kconfig
```kconfig
source "osdrv/extdrv/wireless/realtek/rtl8188f/Kconfig"
source "osdrv/extdrv/wireless/realtek/rtl8189fs/Kconfig"
source "osdrv/extdrv/wireless/realtek/rtl8723ds/Kconfig"
source "osdrv/extdrv/wireless/realtek/rtl8821cs/Kconfig"
```

## osdrv/extdrv/wireless/realtek/rtl8188f/Kconfig
```kconfig
config RTL8188FU
	tristate "Realtek 8188F USB WiFi"
	default m
	---help---
	  Help message of RTL8818FU
```

## osdrv/extdrv/wireless/realtek/rtl8189fs/Kconfig
```kconfig
config RTL8189FS
	tristate "Realtek 8189F SDIO WiFi"
	default m
	---help---
	  Help message of RTL8189FS
```

## ramdisk/configs/cv181x/multi.its
```
/*
 * U-Boot uImage source file with multiple kernels, ramdisks and FDT blobs
 */

/dts-v1/;

/ {
	description = "Various kernels, ramdisks and FDT blobs";
	#address-cells = <2>;

	images {
		kernel-1 {
			description = "cvitek kernel";
			data = /incbin/("./Image.gz");
			type = "kernel";
			arch = "arm64";
			os = "linux";
			compression = "gzip";
			load = <0x0 0x80080000>;
			entry = <0x0 0x80080000>;
			hash-2 {
				algo = "crc32";
			};
		};

		ramdisk-1 {
			description = "cvitek ramdisk";
			data = /incbin/("./rootfs.cpio.gz");
			type = "ramdisk";
			arch = "arm64";
			os = "linux";
			compression = "gzip";
			load = <00000000>;
			entry = <00000000>;
			hash-1 {
				algo = "crc32";
			};
		};

		/*FDT*/

	};

	/*CFG*/

};
```

## ramdisk/configs/cv9520/multi.its
```
/*
 * U-Boot uImage source file with multiple kernels, ramdisks and FDT blobs
 */

/dts-v1/;

/ {
	description = "Various kernels, ramdisks and FDT blobs";
	#address-cells = <2>;

	images {
		kernel-1 {
			description = "cvitek kernel";
			data = /incbin/("./Image.gz");
			type = "kernel";
			arch = "arm64";
			os = "linux";
			compression = "gzip";
			load = <0x1 0x00080000>;
			entry = <0x1 0x00080000>;
			hash-2 {
				algo = "sha256";
			};
		};

		ramdisk-1 {
			description = "cvitek ramdisk";
			data = /incbin/("./rootfs.cpio.gz");
			type = "ramdisk";
			arch = "arm64";
			os = "linux";
			compression = "gzip";
			load = <00000000>;
			entry = <00000000>;
			hash-1 {
				algo = "sha256";
			};
		};

		/*FDT*/
	};

	/*CFG*/
};
```

## ramdisk/rootfs/public/Kconfig
```kconfig
source "../ramdisk/rootfs/public/adbd/Kconfig"
source "../ramdisk/rootfs/public/ap6201bm/Kconfig"
source "../ramdisk/rootfs/public/bluetooth/Kconfig"
source "../ramdisk/rootfs/public/cvitracer/Kconfig"
source "../ramdisk/rootfs/public/dropbear/Kconfig"
source "../ramdisk/rootfs/public/gdbserver/Kconfig"
source "../ramdisk/rootfs/public/libbtrace/Kconfig"
source "../ramdisk/rootfs/public/libcrypto/Kconfig"
source "../ramdisk/rootfs/public/libcurl/Kconfig"
source "../ramdisk/rootfs/public/libevent/Kconfig"
source "../ramdisk/rootfs/public/libiperf/Kconfig"
source "../ramdisk/rootfs/public/libiw/Kconfig"
source "../ramdisk/rootfs/public/libprotobuf/Kconfig"
source "../ramdisk/rootfs/public/libz/Kconfig"
source "../ramdisk/rootfs/public/mtd-utils/Kconfig"
source "../ramdisk/rootfs/public/nanomsg/Kconfig"
source "../ramdisk/rootfs/public/openssl/Kconfig"
source "../ramdisk/rootfs/public/otaserver/Kconfig"
source "../ramdisk/rootfs/public/parted/Kconfig"
source "../ramdisk/rootfs/public/procrank/Kconfig"
source "../ramdisk/rootfs/public/procps/Kconfig"
source "../ramdisk/rootfs/public/python3.7/Kconfig"
source "../ramdisk/rootfs/public/rsyslog/Kconfig"
source "../ramdisk/rootfs/public/secure_image/Kconfig"
source "../ramdisk/rootfs/public/wifi/Kconfig"
source "../ramdisk/rootfs/public/busybox-syslogd/Kconfig"
source "../ramdisk/rootfs/public/mt7603u/Kconfig"
source "../ramdisk/rootfs/public/libtirpc/Kconfig"
source "../ramdisk/rootfs/public/libnfs/Kconfig"
source "../ramdisk/rootfs/public/bash/Kconfig"
source "../ramdisk/rootfs/public/crontabs/Kconfig"
source "../ramdisk/rootfs/public/iperf3-3.1.7/Kconfig"
source "../ramdisk/rootfs/public/e2fsprogs/Kconfig"
source "../ramdisk/rootfs/public/gatord/Kconfig"
source "../ramdisk/rootfs/public/stress-ng/Kconfig"
source "../ramdisk/rootfs/public/htop/Kconfig"
source "../ramdisk/rootfs/public/ntp/Kconfig"
source "../ramdisk/rootfs/public/i2c_tool/Kconfig"
source "../ramdisk/rootfs/public/pinmux/Kconfig"
source "../ramdisk/rootfs/public/envtools/Kconfig"
```

## ramdisk/rootfs/public/ap6201bm/Kconfig
```kconfig
config TARGET_PACKAGE_AP6201BM
	bool "Target package of AP6201BM fw files"
	default n
	help
	  target package of AP6201BM fw and configuration files
```

## ramdisk/rootfs/public/bash/Kconfig
```kconfig
config TARGET_PACKAGE_BASH
	bool "Target package bash"
	default n
	help
	  target bash
```

## ramdisk/rootfs/public/bluetooth/Kconfig
```kconfig
config TARGET_PACKAGE_BT
	bool "Target package bluetooth"
	default n
	help
	  target package bluetooth
```
