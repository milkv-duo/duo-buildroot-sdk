## linux_5.10/drivers/net/wireless/realtek/Kconfig
```kconfig
# SPDX-License-Identifier: GPL-2.0-only
config WLAN_VENDOR_REALTEK
	bool "Realtek devices"
	default y
	help
	  If you have a wireless card belonging to this class, say Y.

	  Note that the answer to this question doesn't directly affect the
	  kernel: saying N will just cause the configurator to skip all the
	  questions about these cards. If you say Y, you will be asked for
	  your specific card in the following questions.

if WLAN_VENDOR_REALTEK

source "drivers/net/wireless/realtek/rtl818x/Kconfig"
source "drivers/net/wireless/realtek/rtlwifi/Kconfig"
source "drivers/net/wireless/realtek/rtl8xxxu/Kconfig"
source "drivers/net/wireless/realtek/rtw88/Kconfig"
source "drivers/net/wireless/realtek/rtl8188f/Kconfig"

config RTL8188FU
    tristate "Realtek 8188F USB WiFi"
    help
      Help message of RTL8818FU
      This is the driver of Realtek wifi drvier.
      This chip work through USB.
      You need to say Y if your board use this chip to implement wifi

config RTL8189FS
    tristate "Realtek 8189F SDIO WiFi"
    help
      Help message of RTL8189FS
      This is the driver of Realtek wifi drvier.
      This chip work through SDIO.
      You need to say Y if your board use this chip to implement wifi

config RTL8723DS
    tristate "Realtek 8723D SDIO or SPI WiFi"
    help
      Help message of RTL8723DS
      This is the driver of Realtek wifi drvier.
      This chip work through SDIO.
      You need to say Y if your board use this chip to implement wifi

config RTL8821CS
    tristate "Realtek 8821C SDIO or SPI WiFi"
    help
      Help message of RTL8821CS
      This is the driver of Realtek wifi drvier.
      This chip work through SDIO.
      You need to say Y if your board use this chip to implement wifi

endif # WLAN_VENDOR_REALTEK
```

## linux_5.10/drivers/pinctrl/cvitek/Kconfig
```kconfig
if ARCH_CVITEK

config CVITEK_PINCTRL_CV1835
	bool "cvitek pinctrl"
	select PINMUX
	select PINCONF
	select GENERIC_PINCONF
	help
	  This enable pinctrl driver for cvitek cv1835 platform
endif
```

## linux_5.10/drivers/soc/cvitek/Kconfig
```kconfig
#
# CVITEK SoC drivers
#
menu "CVITEK SoC drivers"

config CV1835_SYSDMA_REMAP
	bool "CVITEK SoC sysdma remap driver"
	depends on ARCH_CVITEK
	help
	  Enables driver for sysdma remap on CV1835 SoC.
	  If someone need to use sysDMA of CV1835, they
	  need to set src select value of related devices
	  in this top register.

config CVI_WIFI_PIN
	bool "CVITEK SoC wifi specific pin definition"
	depends on ARCH_CVITEK
	help
	  Enables driver for wifi specify pin on CviTek SoC.
	  Enable this configuration to enable API to get
	  GPIO number to do certain action, ex. power on
	  or wakeup pin.

config CVI_BT_PIN
	bool "CVITEK SoC BT specific pin definition"
	depends on ARCH_CVITEK
	help
	  Enables driver for BT specify pin on CviTek SoC.
	  Enable this configuration to enable API to get
	  GPIO number to do certain action, ex. power on
	  or wakeup pin.

endmenu
```

## linux_5.10/drivers/soc/cvitek/rtos_cmdqu/Kconfig
```kconfig
config CVI_MAILBOX
	tristate "cv180x/cv181x mailbox dirver"
	help
		"cv180x/cv181x mailbox driver"
```

## linux_5.10/drivers/video/fbdev/cvitek/Kconfig
```kconfig
config FB_CVITEK
	tristate "Cvitek framebuffer support"
	depends on FB
	select FB_CFB_FILLRECT
	select FB_CFB_COPYAREA
	select FB_CFB_IMAGEBLIT
	help
	  Framebuffer support for the CVITEK SoC.

	  This driver is also available as a module ( = code which can be
	  inserted and removed from the running kernel whenever you want). The
	  module will be called cvifb. If you want to compile it as a module,
	  say M here and read <file:Documentation/kbuild/modules.txt>.
```

## linux_5.10/sound/soc/cvitek/Kconfig
```kconfig
#
# CVITEK Audio Sound SoC drivers
#

config SND_SOC_CV1835_ADAU1372
	tristate "Support for the CV1835-ADAU1372 card"
	help
	  Say y or m if you want to add support for the analog
	  codec ADAU1372 connect to the CVITEK CV1835 boards.
	  Then select it for built in or module.
	  If not, please don't select it

config SND_SOC_CV1835_CV1835PDM
	tristate "Support for the CV1835-CV1835PDM card"
	help
	 Say Y or M if you want to add support for CVITEK PDM connect
	 to CVITEK CV1835 I2S device.
	 Then select it for built in or module.
	 Say N, if not support

config SND_SOC_CV182X_CV182XPDM
	tristate "Support for the CV182X-CV182XPDM card"
	help
	 Say Y or M if you want to add support for CVITEK PDM connect
	 to CVITEK CV182X I2S device.
	 Then select it for built in or module.
	 Say N, if not support

config SND_SOC_CV1835_CV1835ADC
	tristate "Support for the CV1835-CV1835ADC card"
	help
	 Say Y or M if you want to add support for CVITEK ADC connect
	 to CVITEK CV1835 I2S device.
	 Then select it for built in or module.
	 Say N, if not support

config SND_SOC_CV1835_CV1835DAC
	tristate "Support for the CV1835-CV1835ADC card"
	help
	 Say Y or M if you want to add support for CVITEK DAC connect
	 to CVITEK CV1835 I2S device.
	 Then select it for built in or module.
	 Say N, if not support

config SND_SOC_CV182X_CV182XADC
	tristate "Support for the CV182X-CV182XADC card"
	help
	 Say Y or M if you want to add support for CV182X ADC connect
	 to CVITEK CV182X I2S device.
	 Then select it for built in or module.
	 Say N, if not support

config SND_SOC_CV182X_CV182XDAC
	tristate "Support for the CV182X-CV182XADC card"
	help
	 Say Y or M if you want to add support for CVITEK DAC connect
	 to CVITEK CV182X I2S device.
	 Then select it for built in or module.
	 Say N, if not support

config SND_SOC_CV182XA_CV182XAADC
	tristate "Support for the CV182XA-CV182XAADC card"
	help
	 Say Y or M if you want to add support for CV182XA ADC connect
	 to CVITEK CV182XA I2S device.
	 Then select it for built in or module.
	 Say N, if not support

config SND_SOC_CV182XA_CV182XADAC
	tristate "Support for the CV182XA-CV182XADAC card"
	help
	 Say Y or M if you want to add support for CVITEK DAC connect
	 to CVITEK CV182XA I2S device.
	 Then select it for built in or module.
	 Say N, if not support

config SND_CV1835_I2S
	tristate "CVITEK CV1835 I2S Device Driver"
	depends on CLKDEV_LOOKUP
	select SND_SOC_GENERIC_DMAENGINE_PCM
	help
	 Say y or m if you want to add support for I2S driver for
	 CVITEK CV1835 I2S device. The device supports upto maximum of
	 2 channels each for play and record.
	 Say N, if not support

config SND_SOC_CV1835PDM
    tristate "CVITEK CV1835 PDM device driver"
	depends on SND
	help
	 Say y or m if you want to add support for CVITEK PDM driver for
	 CVITEK CV1835 I2S device. The device supports digital external
	 MICs.
	 Say N, if not support

config SND_SOC_CV1835ADC
    tristate "CVITEK CV1835 ADC device driver"
	depends on SND
	help
	 Say y or m if you want to add support for CVITEK ADC driver for
	 CVITEK CV1835 I2S device. The device supports analog external
	 MICs.
	 Say N, if not support

config SND_SOC_CV182XADC
    tristate "CVITEK CV182X ADC device driver"
	depends on SND
	help
	 Say y or m if you want to add support for CVITEK ADC driver for
	 CVITEK CV182X I2S device. The device supports analog external
	 MICs.
	 Say N, if not support

config SND_SOC_CV182XAADC
    tristate "CVITEK CV182XA ADC device driver"
	depends on SND
	help
	 Say y or m if you want to add support for CVITEK ADC driver for
	 CVITEK CV182XA I2S device. The device supports analog external
	 MICs.
	 Say N, if not support

config SND_SOC_CV1835DAC
    tristate "CVITEK CV1835 DAC device driver"
	depends on SND
	help
	 Say y or m if you want to add support for CVITEK DAC driver for
	 CVITEK CV1835 I2S device. The device supports analog external
	 devices (ex. headphone or speaker).
	 Say N, if not support

config SND_SOC_CV182XDAC
    tristate "CVITEK CV182X DAC device driver"
	depends on SND
	help
	 Say y or m if you want to add support for CVITEK DAC driver for
	 CVITEK CV182X I2S device. The device supports analog external
	 devices (ex. headphone or speaker).
	 Say N, if not support

config SND_SOC_CV182XADAC
    tristate "CVITEK CV182XA DAC device driver"
	depends on SND
	help
	 Say y or m if you want to add support for CVITEK DAC driver for
	 CVITEK CV182XA I2S device. The device supports analog external
	 devices (ex. headphone or speaker).
	 Say N, if not support

config SND_SOC_CV1835_CONCURRENT_I2S
	tristate "Support concurrent TX and RX by one I2S and the other I2S"
	depends on SND
	help
	  Say Y, ex. if you want to receive audio data from I2S1 FIFO and
	  transfer audio data to I2S0 FIFO concurrently. This is because
	  of 1 I2S IP only has 1 FIFO, we need to bind 2 I2S IPs with 1 I/O

	  If this device never do concurrent TX/RX, please don't select it

config SND_SOC_CV183x_DUMMY_CARD
	tristate "Support concurrent TX and RX by one I2S and the other I2S"
	depends on SND
	help
	  Say Y, ex. if you want to receive audio data from I2S1 FIFO and
	  transfer audio data to I2S0 FIFO concurrently. This is because
	  of 1 I2S IP only has 1 FIFO, we need to bind 2 I2S IPs with 1 I/O

	  If this device never do concurrent TX/RX, please don't select it

config SND_SOC_CV1835_USE_AUDIO_PLL
	tristate "Use internal audio PLL as I2S clock source"
	depends on SND
	help
	  Say Y, ex. if you want to use internal audio PLL (24.576Mhz) as
	  I2S MCLK input. Enable this configuration, we don't need to use
	  external oscillator to provide MCLK clock. But be remember to enable
	  MCLK out if codec also need MCLK clock.

config CV1835_I2S_SUBSYS
	bool "cvitek i2s tdm sub-system driver"
	depends on SND
	help
	  Enable cvitek i2s_tdm sub-system driver to do i2s_tdm configuration.
	  One need to set this sub-system if he want to do multi-record at the same
	  time.
	  Or do TX/RX simutaneously. ex. set I2S0 as RX and I2S1 as TX.
	  Due to 1 I2S IP only has 1 FIFO. One must do this setting.

config SND_SOC_CV1835_LT9611
	tristate "Support for the lt9611 card"
	help
	  lt9611 codec enable.
```

## osdrv/extdrv/tp/Kconfig
```kconfig
#
# tp device configuration
#

source "osdrv/extdrv/tp/ts_gsl/Kconfig"
source "osdrv/extdrv/tp/ts_gt9xx/Kconfig"
```

## osdrv/extdrv/tp/ts_gsl/Kconfig
```kconfig
#
# Touchscreen driver configuration
#

config TOUCHSCREEN_TSGSL
	tristate "betterlife tp"
	default m
	---help-- -
	betterlife fingerprint.
```

## osdrv/extdrv/tp/ts_gt9xx/Kconfig
```kconfig
#
# Touchscreen driver configuration
#

config TOUCHSCREEN_TSGT9XX
	tristate "goodix,gt911 tp"
	default m
	---help-- -
	goodix,gt911 fingerprint.
```

## osdrv/extdrv/wireless/Kconfig
```kconfig
#
# Wireless LAN device configuration
#

source "osdrv/extdrv/wireless/realtek/Kconfig"
source "osdrv/extdrv/wireless/bcmdhd/Kconfig"
source "osdrv/extdrv/wireless/mediatek/Kconfig"
source "osdrv/extdrv/wireless/icommsemi/Kconfig"
```

## osdrv/extdrv/wireless/icommsemi/sv6115/Kconfig
```kconfig
config SV6115
	tristate "ICOMMSEMI SV6115 USB WiFi"
	---help---
		Enable iComm-semi SV6115 WLAN kernel driver.
```
